#include <stdlib.h>
#include <stdint.h>
#include <stdbool.h>
#include <stdio.h>
#include <string.h>

#ifdef ENV_HOSTPC
#include <stdint.h>
#include <stdio.h>
#include <unistd.h>
#include "cli/command.h"
#include "cli/cli.h"
#else
#include "command.h"
#include "cli.h"
#include "system_common.h"
#include "module_testcase.h"
#include "uart.h"
#include "timer.h"
#endif

#include "../../vip/reg.h"
#include "../inc/isp_reg.h"

#include "../sensorlist.h"
#include "../vip_common.h"



#undef uartlog
#define uartlog(fmt, args...) \
{ \
    printf(fmt, ##args); \
    fflush(stdout); \
}

#define CIF_DPHY_ENABLE

static uint32_t	      sensor_mode;

struct sensor_mode os08a10_mode[] = {
	{
		.name = "720p30",
		.bit_depth = 10,
		.bayer = SENSOR_BAYER_BG,
		.active_w = 1280,
		.active_h = 720,
		.total_w = 1280,
		.total_h = 720,
		.fp_w = 0,
		.bp_w = 0,
		.fp_h = 0,
		.bp_h = 0,	// in spec it shall be 5 but csi-bdg report frame err.
	},
	{
		.name = "720p30_hdr_dt",
		.bit_depth = 10,
		.bayer = SENSOR_BAYER_BG,
		.active_w = 1280,
		.active_h = 774,
		.total_w = 1280,
		.total_h = 774,
		.fp_w = 0,
		.bp_w = 0,
		.fp_h = 0,
		.bp_h = 0,	// in spec it shall be 5 but csi-bdg report frame err.
	},
	{
		.name = "720p30_hdr_vc",
		.bit_depth = 10,
		.bayer = SENSOR_BAYER_BG,
		.active_w = 1280,
		.active_h = 720,
		.total_w = 1280,
		.total_h = 720,
		.fp_w = 0,
		.bp_w = 0,
		.fp_h = 0,
		.bp_h = 0,	// in spec it shall be 5 but csi-bdg report frame err.
	},
};

struct sensor_info os08a10_info = {
	.dev = 0x36, //0x10,
	.alen = 2,
	.dlen = 1,
	.gain =  { .cur = 0, .min = 0, .max = 0xf0 },
	.sgain =  { .cur = 0, .min = 0, .max = 0xf0 },
	.shsl =  { .cur = 0, .min = 0, .max = 0 },
	.shss =  { .cur = 0, .min = 0, .max = 0 },
	.ops = &os08a10_ops,
};

static void os08a10_set_shsl(void *priv, uint32_t shs)
{
	struct sensor_info *sinf = (struct sensor_info *)priv;

	sinf->adpt->write(sinf->adpt, sinf->dev, 0x3502, sinf->alen, (uint8_t*)&(shs), 1);
	sinf->adpt->write(sinf->adpt, sinf->dev, 0x3501, sinf->alen, ((uint8_t*)&(shs)) + 1, 1);
	sinf->shsl.cur = shs;

	return;
}

static void os08a10_set_shss(void *priv, uint32_t shs)
{
	struct sensor_info *sinf = (struct sensor_info *)priv;

	sinf->adpt->write(sinf->adpt, sinf->dev, 0x3512, sinf->alen, (uint8_t*)&(shs), 1);
	sinf->adpt->write(sinf->adpt, sinf->dev, 0x3511, sinf->alen, ((uint8_t*)&(shs)) + 1, 1);
	sinf->shsl.cur = shs;

	return;
}

static void os08a10_set_gain(void *priv, uint16_t gain)
{
	struct sensor_info *sinf = (struct sensor_info *)priv;

	sinf->adpt->write(sinf->adpt, sinf->dev, 0x3509, sinf->alen, (uint8_t*)&(gain), 1);
	sinf->adpt->write(sinf->adpt, sinf->dev, 0x3508, sinf->alen, ((uint8_t*)&(gain)) + 1, 1);
	sinf->gain.cur = gain;

	return;
}

static void os08a10_set_sgain(void *priv, uint16_t gain)
{
	struct sensor_info *sinf = (struct sensor_info *)priv;

	sinf->adpt->write(sinf->adpt, sinf->dev, 0x350D, sinf->alen, (uint8_t*)&(gain), 1);
	sinf->adpt->write(sinf->adpt, sinf->dev, 0x350C, sinf->alen, ((uint8_t*)&(gain)) + 1, 1);
	sinf->shsl.cur = gain;

	return;
}

struct sensor_ops os08a10_ops = {
	.set_gain = os08a10_set_gain,
	.set_sgain = os08a10_set_sgain,
	.set_shsl = os08a10_set_shsl,
	.set_shss = os08a10_set_shss,
};

#define OS08A10_TEST_PATTERN_REG       0x5081
#define OS081A0_TEST_PTN_DISABLE       0x00
//#define OS081A0_TEST_PTN_COLOR_BAR     0x80
#define OS081A0_TEST_PTN_COLOR_BAR     0x92
#define OS08A10_DEFAULT_SHS		0x1F

struct sensor_setting os08a10_init_720p_4lane[] = {
	{0x0100, 0x00},
	{0x0103, 0x01},
	{0x0303, 0x01},
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	{0x0305, 0x12},
	//{0x0325, 0x45},
	//{0x380c, 0x10}, // ori
	//{0x380d, 0x9f},
	//{0x380c, 0x1B},
	//{0x380d, 0x58},
	{0x380c, 0x19}, //latest
	{0x380d, 0xC8},
	{0x4837, 0x10},
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	{0x0100, 0x01},
};

struct sensor_setting os08a10_init_720p_2lane[] = {
	{0x0100, 0x00},
	{0x0103, 0x01},
	{0x0303, 0x01},
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	{0x0305, 0x12},
	//{0x0325, 0x45},
	//{0x380c, 0x10}, // ori
	//{0x380d, 0x9f},
	//{0x380c, 0x23},
	//{0x380d, 0x28},
	{0x380c, 0x19}, //latest
	{0x380d, 0xC8},
	{0x4837, 0x10},
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	{0x0100, 0x01},
};

struct sensor_setting os08a10_init_720p_2lane_hdr_dt[] = {
	{0x0100, 0x00},
	{0x0103, 0x01},
	{0x0303, 0x01},
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	{0x4809, 0x19},
	//{0x4809, 0x2b}, // Long exposure data type
	{0x4812, 0x2b}, // Short exposure data type
	{0x4813, 0x98},
	{0x4817, 0x04},
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	{0x3502, 0x50},
	{0x3511, OS08A10_DEFAULT_SHS>>8}, // short exposure shutter
	{0x3512, OS08A10_DEFAULT_SHS&0xFF},
	{0x3833, 0x01},
	{0x3808, 0x05},
	{0x3809, 0x00},
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	{0x3012, 0x21},
	//{0x380c, 0x08}, // ori
	//{0x380d, 0x18},
	{0x380c, 0x19}, //latest
	{0x380d, 0xC8},
	{0x0100, 0x01},
	{0x0100, 0x01},
	{0x0100, 0x01},
	{0x0100, 0x01},
};

struct sensor_setting os08a10_init_720p_2lane_hdr_vc[] = {
	{0x0100, 0x00},
	{0x0103, 0x01},
	{0x0303, 0x01},
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	{0x380d, 0x18},
	//{0x380c, 0x19}, //latest
	//{0x380d, 0xC8},
	{0x0100, 0x01},
	{0x0100, 0x01},
	{0x0100, 0x01},
	{0x0100, 0x01},
};

#if defined(BOARD_ASIC) && defined(CIF_DPHY_ENABLE)
static uint32_t	use_4L = 1;
#endif

int os08a10_poweron(void *priv)
{
	pattern_ctx *ctx = (pattern_ctx *)priv;
	struct sensor_info *sinf = (struct sensor_info *)ctx->ptn->priv;
	struct snr_i2c_adapter *adpt = NULL;
	struct sensor_setting *sensor_set = os08a10_init_720p_4lane;
	int setting_num = ARRAY_SIZE(os08a10_init_720p_4lane);
	struct sensor_setting *pset;
	char cmdbuf[8];
	struct sensor_mode *mode = &os08a10_mode[OS08A10_MODE_720P30];
	int i, r, test_pn = 0;
	uint32_t value;
	uint32_t hdr = 0, tmp;

	disable_irq(CSIMAC0_INTR_NUM);
#if defined(BOARD_ASIC) && defined(CIF_DPHY_ENABLE)
	// Switch the PHY type to MIPI-CSI
	// uartlog("start phya reset\n");
	value = readl(0x0A0D00F0);
	value &= ~0x1;
	writel(0x0A0D00F0, value);
	// Switch the CLK Select
	value = readl(0x0A0D00004);
	value |= (0x8<<8);
	writel(0x0A0D0004, value);
	// Config the PHYD lane enable
	value = readl(0x0A0D0024);
	value &= ~0xFF0FFFFF;
	writel(0x0A0D0024, value);
	// PHYD lane enable
	value |= (use_4L ? 0x0F000000 :0x03000000);
	// CLK INV
	value |= (use_4L ? (0xF<<20) : (0x3<<20));
	value |= 0x01243;
	writel(0x0A0D0024, value);
	// PHYA lane enable
	value = readl(0x0A0D0000);
	value &= ~(0x1<<12);
	value &= ~(0x1F<<16);
	writel(0x0A0D0000, value);
#endif

	// i2c config here
	snr_bm_i2c_get_adap((void *)&adpt);
	sinf->adpt = adpt;

	adpt->slaveaddr = sinf->dev;
	snr_bm_i2c_init(adpt);

	bm_get_num("HDR OFF(0), HDR-DT(1), HDR-VC(2):", hdr);

	switch(sensor_mode) {
	case 0:
		uartlog("1280x720 4 lanes\n");
		sensor_set = os08a10_init_720p_4lane;
		setting_num = ARRAY_SIZE(os08a10_init_720p_4lane);
		break;
	case 1:
		if (!hdr) {
			// linear
			uartlog("1280x720 2 lanes\n");
			sensor_set = os08a10_init_720p_2lane;
			setting_num = ARRAY_SIZE(os08a10_init_720p_2lane);
			writel(0x0a0c2040, 0x0);
		} else if (hdr == 1) {
			sinf->ishdr = true;
			sinf->shsl.cur = OS08A10_DEFAULT_SHS;
			// hdr-dt
			uartlog("1280x720 2 lanes hdr-dt\n");
			sensor_set = os08a10_init_720p_2lane_hdr_dt;
			setting_num = ARRAY_SIZE(os08a10_init_720p_2lane_hdr_dt);
			mode = &os08a10_mode[OS08A10_MODE_720P30_HDR_DT];
                        // config the csi hdr dt mode.
			//writel(0x0a0c2470, 0);
			// enable the dt mode.
			value = 0x01 | (0x2b<<4) | (0x2b<<12) | (0x19<<20);
			writel(0x0a0c2474, value);
                        value = readl(0x0a0c2404);
                        value &= ~0x020000;
                        value |= 0x010000;
                        writel(0x0a0c2404, value);
		} else {
			uartlog("1280x720 2 lanes hdr-vc\n");
			sensor_set = os08a10_init_720p_2lane_hdr_vc;
			setting_num = ARRAY_SIZE(os08a10_init_720p_2lane_hdr_vc);
			mode = &os08a10_mode[OS08A10_MODE_720P30_HDR_VC];
                        // config the csi hdr vc mode.
                        value = readl(0x0a0c2404);
                        value &= ~0x020000;
                        value |= 0x010000;
                        writel(0x0a0c2404, value);
		}
		break;
	default:
		uartlog("unspport sensor format!\n");
		return -1;
	}

	cmdbuf[0] = cmdbuf[1] = '0';
	cli_readline("enable test pattern? [n/y]", cmdbuf);
	if (cmdbuf[0] == 'y') {
		test_pn = 1;
	}

	// i2c initial sequence
	for (i = 0; i < setting_num; i++) {
		pset = &(sensor_set[i]);

		if (pset->addr == SNR_MARKER_DELAY) {
			uartlog("sensor wr delay\n");
			udelay(pset->val);
			continue;
		}
		r = sinf->adpt->write(sinf->adpt, sinf->dev, pset->addr, sinf->alen, (uint8_t*)&(pset->val), 1);
		if (r < 0)
			uartlog("%s i2c_write fail addr[0x%x]\n", ctx->ptn->name, pset->addr);
	}

	value = test_pn ? OS081A0_TEST_PTN_COLOR_BAR : OS081A0_TEST_PTN_DISABLE;
	r = sinf->adpt->write(sinf->adpt, sinf->dev, OS08A10_TEST_PATTERN_REG,
			      sinf->alen, (uint8_t*)&value, 1);
	if (r < 0)
		uartlog("%s i2c_write fail addr[0x%x]\n", ctx->ptn->name, OS08A10_TEST_PATTERN_REG);


	uartlog("Read back i2c registers:\n");
	for (i = 0; i < setting_num; i++) {
		uint16_t val = 0;

		pset = &(sensor_set[i]);
		r = sinf->adpt->read(sinf->adpt, sinf->dev, pset->addr, sinf->alen, (uint8_t*)&val, 1);

		uartlog("reg[0x%x]=0x%x(0x%x)\n", pset->addr, val, pset->val);
	}

#if defined(BOARD_FPGA) && defined(CIF_DPHY_ENABLE)
	// Switch the PHY type to MIPI-CSI
	value = readl(0x0A0D00F0);
	value &= ~0x1;
	writel(0x0A0D00F0, value);
	// Switch the CLK Select
	value = readl(0x0A0D0004);
	value |= (0x1<<8);
	writel(0x0A0D0004, value);
	// config the auto scan
	writel(0x0A0D0054, 0x07010701);
	// Config the PHYD lane enable
	value = readl(0x0A0D0024);
	value &= ~0xFF000000;
	writel(0x0A0D0024, value);
	if (sensor_mode == 1)
		value |= 0x03000000;
	else
		value |= 0x0f000000;
	value |= 0x43210;
	writel(0x0A0D0024, value);
	// PHYA lane enable
	value = readl(0x0A0D0000);
	value &= ~(0x1<<12);
	value &= ~(0x1F<<16);
	writel(0x0A0D0000, value);
#endif

	uartlog("streaming start\n");

	cmdbuf[0] = cmdbuf[1] = '0';
	cli_readline("run sensor to dram flow? [n/y]", cmdbuf);
	if (cmdbuf[0] == 'y') {
		uartlog("dump %d x %d \n", mode->total_w, mode->total_h);
		config_csibdg(0, mode->total_w,
				mode->total_h,
				ctx, hdr, 0);
	}
	return 0;
}

int os08a10_intr(void *priv)
{
	uint32_t value;

	value = readl(0x0a0c2460);
	uartlog("csi status intr 0x%x\n", value);
	// clear the interrupt status
	value = readl(0x0a0c2404) | ((value&0xFF)<<8);
	writel(0x0a0c2404, value);

	return 0;
}

#define HARD_REG_GPIOD7_DAT      (0x03023000)
#define HARD_REG_GPIOD7_OE       (0x03023004)

int peri_up_4(void *priv)
{
#define CAM0PLL_SYNC_SET		393705325UL
#define CAM0PLL_DIV_SEL			11
#define CAM0PLL_POST_DIV_SEL		1
#define CAM0PLL_ICTRL			0
#define CAM0PLL_SEL_MODE		1
#define CAM0PLL_PRE_DIV_SEL		1
#define CMA0PLL_CLK_DIV			45

	char cmdbuf[8];
#if !defined(FLOW_AFTER_ECO)
	unsigned int *fpga_pwr_reg;
#endif
	uint32_t value, tmp;

	cmdbuf[0] = '0';
	cli_readline("### enter to start power-on seqeuence. s) to skip : ", cmdbuf);
	if (cmdbuf[0] == 's')
		return 0;

	bm_get_num("output 720P60-4L(default-0), 720P30-2L(1)", sensor_mode);
	// power down/reset
	// 1.2V = 1, 1.8V = 1, 2.9V = 1
	// INCK on
	// XCLR = 0
	// wait 500ns, wait INCK stable
	// XCLR = 1
	// wait 20us
#if defined(BOARD_ASIC)
	// power on/reset
	// 1.2V = 1, 1.8V = 1, 2.9V = 1
	// INCK on
	// enable cam0pll clk source
	value = readl(0x03002030);
	value &= ~(1<<28);
	writel(0x03002030, value);
	// cam0pll dividor factor
	writel(0x030020F4, (CMA0PLL_CLK_DIV<<16)|0x09);
	// set sync source en
	value = readl(0x03002840);
	value |= (1<<4);
	writel(0x03002840, value);
	// set sync set
	writel(0x03002874, CAM0PLL_SYNC_SET);
	// set sync set sw up
	value = readl(0x03002870);
	value ^= 0x01;
	writel(0x03002870, value);
	// set csr
	value = CAM0PLL_PRE_DIV_SEL | (CAM0PLL_POST_DIV_SEL << 8) | (CAM0PLL_SEL_MODE << 15) | (CAM0PLL_DIV_SEL << 17)
		| (CAM0PLL_ICTRL << 24);
	writel(0x03002814, value);
	// clear pwd
	value = readl(0x03002800);
	value &= ~(1<<12);
	writel(0x03002800, value);
	udelay(100);
	// XCLR = 0
	writel(HARD_REG_GPIOD7_DAT, 0x00);
	writel(HARD_REG_GPIOD7_OE, 0x80);
	// wait 500ns, wait INCK stable
	udelay(1);
	// XCLR = 1
	writel(HARD_REG_GPIOD7_DAT, 0x80);
	// wait 20us
	udelay(20);
#endif

#if !defined(FLOW_AFTER_ECO)
	// enable display clk select
	value = readl(0x0a0c8018);
	value |= 0x02;
	writel(0x0a0c8018, value);
	udelay(5000);
#endif

	// Switch the MAC type to MIPI-CSI
	writel(0x0a0c2000, 0x00000071);
	value = readl(0x0a0c2400);
	// config lane number
	if (sensor_mode == 1)
		value |= 0x01;
	else
		value |= 0x03;
	// config force video format
	// value |= (0x8<<16) | (0x01<<13);
	// Enable SOL
	//value |= (0x1<<12);
	writel(0x0a0c2400, value);
	// config the vs gen mode.
	writel(0x0a0c2470, 0xA00);
#if !defined(FLOW_AFTER_ECO)
	fpga_pwr_reg = (unsigned int *)HARD_REG_FPGA_PWRPIN;
	// power sequence
	writel(fpga_pwr_reg, 0);
	uartlog("power-on delay\n");
	udelay(5000);
	writel(fpga_pwr_reg, 0x08);
	uartlog("power-on delay\n");
	udelay(5000);
	writel(fpga_pwr_reg, 0x18);
	uartlog("power-on delay\n");
	udelay(5000);
	writel(fpga_pwr_reg, 0x38);
	uartlog("power-on delay\n");
	udelay(5000);
	// clear reset and enable phy rx
	writel(fpga_pwr_reg, 0x32100039);
#endif
	uartlog("### device poweron\n");

	return 0;
}

int peri_down_4(void *priv)
{
	char cmdbuf[8] = {0};

	cli_readline("### power-off? y/n", cmdbuf);

	if (cmdbuf[0] == 'y') {
#if !defined(FLOW_AFTER_ECO)
		unsigned int *fpga_pwr_reg;

		fpga_pwr_reg = (unsigned int *)HARD_REG_FPGA_PWRPIN;
		// INCLK = 0
		// XCLR = 0
		// POWER-OFF sequence
		uartlog("power-off");
		writel(fpga_pwr_reg, 0x18);
		udelay(5000);
		writel(fpga_pwr_reg, 0x08);
		udelay(5000);
		writel(fpga_pwr_reg, 0);
		udelay(5000);
#endif
	}

	return 0;
}

