#include <stdlib.h>
#include <stdint.h>
#include <stdbool.h>
#include <stdio.h>
#include <string.h>

#ifdef ENV_HOSTPC
#include <stdint.h>
#include <stdio.h>
#include <unistd.h>
#include "cli/command.h"
#include "cli/cli.h"
#else
#include "command.h"
#include "cli.h"
#include "system_common.h"
#include "module_testcase.h"
#include "uart.h"
#include "timer.h"
#endif

#include "../../vip/reg.h"
#include "../inc/isp_reg.h"

#include "../sensorlist.h"
#include "../vip_common.h"


#define HARD_REG_GPIOD7_DAT      (0x03023000)
#define HARD_REG_GPIOD7_OE       (0x03023004)

#undef uartlog
#define uartlog(fmt, args...) \
{ \
    printf(fmt, ##args); \
    fflush(stdout); \
}

#define CIF_DPHY_ENABLE

static uint32_t	      sensor_mode;
#if defined(BOARD_ASIC) && defined(CIF_DPHY_ENABLE)
static uint32_t	use_4L = 1;
static uint8_t lane_map[5] = {1, 2, 3, 0, 4};
#endif

struct sensor_mode os08a20_slave_mode[] = {
	{
		.name = "2592x1944",
		.bit_depth = 10,
		.bayer = SENSOR_BAYER_BG,
		.active_w = 2592,
		.active_h = 1944,
		.total_w = 2592,
		.total_h = 1944,
		.fp_w = 0,
		.bp_w = 0,
		.fp_h = 0,
		.bp_h = 0,	// in spec it shall be 5 but csi-bdg report frame err.
	},
	{
		.name = "3840x2160",
		.bit_depth = 10,
		.bayer = SENSOR_BAYER_BG,
		.active_w = 3840,
		.active_h = 2160,
		.total_w = 3840,
		.total_h = 2160,
		.fp_w = 0,
		.bp_w = 0,
		.fp_h = 0,
		.bp_h = 0,	// in spec it shall be 5 but csi-bdg report frame err.
	},
	{
		.name = "2592x1944-HDR",
		.bit_depth = 10,
		.bayer = SENSOR_BAYER_BG,
		.active_w = 2592,
		.active_h = 1944,
		.total_w = 2592,
		.total_h = 1944,
		.fp_w = 0,
		.bp_w = 0,
		.fp_h = 0,
		.bp_h = 0,	// in spec it shall be 5 but csi-bdg report frame err.
	},
	{
		.name = "3840x2160-HDR",
		.bit_depth = 10,
		.bayer = SENSOR_BAYER_BG,
		.active_w = 3840,
		.active_h = 2160,
		.total_w = 3840,
		.total_h = 2160,
		.fp_w = 0,
		.bp_w = 0,
		.fp_h = 0,
		.bp_h = 0,	// in spec it shall be 5 but csi-bdg report frame err.
	},
};

struct sensor_info os08a20_slave_info = {
	.dev = 0x36, //0x10,
	.alen = 2,
	.dlen = 1,
	.gain =  { .cur = 0, .min = 0, .max = 0xf0 },
	.sgain =  { .cur = 0, .min = 0, .max = 0xf0 },
	.shsl =  { .cur = 0, .min = 0, .max = 0 },
	.shss =  { .cur = 0, .min = 0, .max = 0 },
	.ops = &os08a20_slave_ops,
};

static void os08a20_slave_set_shsl(void *priv, uint32_t shs)
{
	struct sensor_info *sinf = (struct sensor_info *)priv;

	sinf->adpt->write(sinf->adpt, sinf->dev, 0x3502, sinf->alen, (uint8_t*)&(shs), 1);
	sinf->adpt->write(sinf->adpt, sinf->dev, 0x3501, sinf->alen, ((uint8_t*)&(shs)) + 1, 1);
	sinf->shsl.cur = shs;

	return;
}

static void os08a20_slave_set_shss(void *priv, uint32_t shs)
{
	struct sensor_info *sinf = (struct sensor_info *)priv;

	sinf->adpt->write(sinf->adpt, sinf->dev, 0x3512, sinf->alen, (uint8_t*)&(shs), 1);
	sinf->adpt->write(sinf->adpt, sinf->dev, 0x3511, sinf->alen, ((uint8_t*)&(shs)) + 1, 1);
	sinf->shsl.cur = shs;

	return;
}

static void os08a20_slave_set_gain(void *priv, uint16_t gain)
{
	struct sensor_info *sinf = (struct sensor_info *)priv;

	sinf->adpt->write(sinf->adpt, sinf->dev, 0x3509, sinf->alen, (uint8_t*)&(gain), 1);
	sinf->adpt->write(sinf->adpt, sinf->dev, 0x3508, sinf->alen, ((uint8_t*)&(gain)) + 1, 1);
	sinf->gain.cur = gain;

	return;
}

static void os08a20_slave_set_sgain(void *priv, uint16_t gain)
{
	struct sensor_info *sinf = (struct sensor_info *)priv;

	sinf->adpt->write(sinf->adpt, sinf->dev, 0x350D, sinf->alen, (uint8_t*)&(gain), 1);
	sinf->adpt->write(sinf->adpt, sinf->dev, 0x350C, sinf->alen, ((uint8_t*)&(gain)) + 1, 1);
	sinf->shsl.cur = gain;

	return;
}

struct sensor_ops os08a20_slave_ops = {
	.set_gain = os08a20_slave_set_gain,
	.set_sgain = os08a20_slave_set_sgain,
	.set_shsl = os08a20_slave_set_shsl,
	.set_shss = os08a20_slave_set_shss,
};

#define OS08A20_TEST_PATTERN_REG       0x5081
#define OS08A20_TEST_PTN_DISABLE       0x00
//#define OS08A20_TEST_PTN_COLOR_BAR     0x80
#define OS08A20_TEST_PTN_COLOR_BAR     0x92
#define OS08A20_DEFAULT_SHS		0x1F

struct sensor_setting os08a20_slave_init_2592x1944_4lane[] = {
	{0x0100, 0x00},
	{0x0103, 0x01},
	{0x0303, 0x01},
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	{0x0100, 0x01},
};

struct sensor_setting os08a20_slave_init_2592x1944_4lane_hdr[] = {
	{0x0100, 0x00},
	{0x0103, 0x01},
	{0x0303, 0x01},
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	{0x0100, 0x01},
};

struct sensor_setting os08a20_slave_init_3840x2160_4lane[] = {
	{0x0100, 0x00},
	{0x0103, 0x01},
	{0x0303, 0x01},
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	{0x0100, 0x01},
};

struct sensor_setting os08a20_slave_init_3840x2160_4lane_hdr[] = {
	{0x0100, 0x00},
	{0x0103, 0x01},
	{0x0303, 0x01},
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	{0x0100, 0x01},
};

int os08a20_slave_poweron(void *priv)
{
	pattern_ctx ctx_tmp;
	pattern_ctx *ctx = (pattern_ctx *)&ctx_tmp;
	struct sensor_info *sinf = (struct sensor_info *)&os08a20_slave_info;
	//struct sensor_info *sinf = (struct sensor_info *)ctx->ptn->priv;
	struct snr_i2c_adapter *adpt = NULL;
	struct sensor_setting *sensor_set = os08a20_slave_init_2592x1944_4lane;
	int setting_num = ARRAY_SIZE(os08a20_slave_init_2592x1944_4lane);
	struct sensor_setting *pset;
	char cmdbuf[8];
	struct sensor_mode *mode = &os08a20_slave_mode[OS08A20_MODE_2592_1944];
	int i, r, test_pn = 0;
	uint32_t value;
	uint32_t hdr = 0, tmp;

#if defined(BOARD_ASIC) && defined(CIF_DPHY_ENABLE)
	// Switch the PHY type to MIPI-CSI
	// uartlog("start phya reset\n");
	value = readl(0x0300D0F0);
	value &= ~0x1;
	writel(0x0300D0F0, value);
	// Switch the CLK Select
	value = readl(0x0300D004);
	value |= ((1<<lane_map[0])<<8);
	writel(0x0300D004, value);
	// Config the PHYD lane enable
	value = readl(0x0300D028);
	value &= ~0xFF0FFFFF;
	writel(0x0300D028, value);
	// PHYD lane enable
	value |= (use_4L ? 0x0F000000 :0x03000000);
	// CLK INV
	value |= (use_4L ? (0xF<<20) : (0x3<<20));
	for (i=0; i<5; i++) {
		value |= (lane_map[i]&0xF)<<(i*4);
	}
	writel(0x0300D028, value);
	// PHYA lane enable
	value = readl(0x0300D000);
	value &= ~(0x1<<26);
	value &= ~(0x1F<<27);
	writel(0x0300D000, value);
#endif

	// i2c config here
	snr_bm_i2c_get_adap((void *)&adpt);
	sinf->adpt = adpt;

	adpt->slaveaddr = sinf->dev;
	snr_bm_i2c_init(adpt);

	bm_get_num("2592x1944(0), 3840x2160(1)", sensor_mode);
	bm_get_num("HDR OFF(0), HDR ON(1)", hdr);

	switch(sensor_mode) {
	case 0:
		if (!hdr) {
			// linear
			uartlog("2592x1944 4 lanes\n");
			sensor_set = os08a20_slave_init_2592x1944_4lane;
			setting_num = ARRAY_SIZE(os08a20_slave_init_2592x1944_4lane);
			mode = &os08a20_slave_mode[OS08A20_MODE_2592_1944];
			writel(0x0a0c4040, 0x0);
		} else {
			sinf->ishdr = true;
			sinf->shsl.cur = OS08A20_DEFAULT_SHS;
			// hdr
			uartlog("2592x1944 4 lanes hdr\n");
			sensor_set = os08a20_slave_init_2592x1944_4lane_hdr;
			setting_num = ARRAY_SIZE(os08a20_slave_init_2592x1944_4lane_hdr);
			mode = &os08a20_slave_mode[OS08A20_MODE_2592_1944_HDR];
			writel(0x0a0c4470, 0);
			// enable the dt mode.
			value = 0x01 | (0x2b<<4) | (0x2b<<12) | (0x19<<20);
			writel(0x0a0c4474, value);
                        // enable the csi hdr mode.
                        value = readl(0x0a0c4408);
                        value |= 0x01;
                        writel(0x0a0c4408, value);
		}
		break;
	case 1:
		if (!hdr) {
			// linear
			uartlog("3840x2160 4 lanes\n");
			sensor_set = os08a20_slave_init_3840x2160_4lane;
			setting_num = ARRAY_SIZE(os08a20_slave_init_3840x2160_4lane);
			mode = &os08a20_slave_mode[OS08A20_MODE_3840_2160];
			writel(0x0a0c4040, 0x0);
		} else {
			sinf->ishdr = true;
			sinf->shsl.cur = OS08A20_DEFAULT_SHS;
			// hdr-dt
			uartlog("3840x2160 4 lanes hdr\n");
			sensor_set = os08a20_slave_init_3840x2160_4lane_hdr;
			setting_num = ARRAY_SIZE(os08a20_slave_init_3840x2160_4lane);
			mode = &os08a20_slave_mode[OS08A20_MODE_3840_2160_HDR];
			writel(0x0a0c4470, 0);
			// enable the dt mode.
			value = 0x01 | (0x2b<<4) | (0x2b<<12) | (0x19<<20);
			writel(0x0a0c4474, value);
                        // enable the csi hdr mode.
                        value = readl(0x0a0c4408);
                        value |= 0x01;
                        writel(0x0a0c4408, value);
		}
		break;
	default:
		uartlog("unspport sensor format!\n");
		return -1;
	}

	// i2c initial sequence
	for (i = 0; i < setting_num; i++) {
		pset = &(sensor_set[i]);

		if (pset->addr == SNR_MARKER_DELAY) {
			uartlog("sensor wr delay\n");
			udelay(pset->val);
			continue;
		}
		r = sinf->adpt->write(sinf->adpt, sinf->dev, pset->addr, sinf->alen, (uint8_t*)&(pset->val), 1);
		if (r < 0)
			uartlog("%s i2c_write fail addr[0x%x]\n", ctx->ptn->name, pset->addr);
	}

	value = test_pn ? OS08A20_TEST_PTN_COLOR_BAR : OS08A20_TEST_PTN_DISABLE;
	r = sinf->adpt->write(sinf->adpt, sinf->dev, OS08A20_TEST_PATTERN_REG,
			      sinf->alen, (uint8_t*)&value, 1);
	if (r < 0)
		uartlog("%s i2c_write fail addr[0x%x]\n", ctx->ptn->name, OS08A20_TEST_PATTERN_REG);


	uartlog("Read back i2c registers:\n");
	for (i = 0; i < setting_num; i++) {
		uint16_t val = 0;

		pset = &(sensor_set[i]);
		r = sinf->adpt->read(sinf->adpt, sinf->dev, pset->addr, sinf->alen, (uint8_t*)&val, 1);

		uartlog("reg[0x%x]=0x%x(0x%x)\n", pset->addr, val, pset->val);
	}

#if defined(BOARD_FPGA) && defined(CIF_DPHY_ENABLE)
	// Switch the PHY type to MIPI-CSI
	value = readl(0x0300D0F0);
	value &= ~0x1;
	writel(0x0300D0F0, value);
	// Config the PHYD lane enable
	value = readl(0x0300D028);
	value &= ~0xFF000000;
	writel(0x0300D028, value);
	value |= 0x0f000000;
	writel(0x0300D028, value);
#endif

	uartlog("stop here!!\n");
	while(1);

	cmdbuf[0] = cmdbuf[1] = '0';
	cli_readline("run sensor to dram flow? [n/y]", cmdbuf);
	if (cmdbuf[0] == 'y') {
		unsigned int lines;
		
		if (sensor_mode == 0)
			lines = hdr==1?mode->total_h+sinf->shsl.cur+49:mode->total_h;
		else
			lines = hdr==1?mode->total_h+sinf->shsl.cur+57:mode->total_h;
		uartlog("dump %d x %d \n", mode->total_w, lines);
		config_csibdg(0, mode->total_w,
				lines,
				ctx, !!hdr, 0);
	}
	return 0;
}

int os08a20_slave_intr(void *priv)
{
	uint32_t value;

	value = readl(0x0a0c4460);
	uartlog("csi status intr 0x%x\n", value);
	// clear the interrupt status
	value = readl(0x0a0c4404) | ((value&0xFF)<<8);
	writel(0x0a0c4404, value);

	return 0;
}

int peri_up_os08a20_slave(void *priv)
{
#define CAM0PLL_SYNC_SET		393705325UL
#define CAM0PLL_DIV_SEL			11
#define CAM0PLL_POST_DIV_SEL		1
#define CAM0PLL_ICTRL			0
#define CAM0PLL_SEL_MODE		1
#define CAM0PLL_PRE_DIV_SEL		1
#define CMA0PLL_CLK_DIV			45

#if !defined(FLOW_AFTER_ECO)
	unsigned int *fpga_pwr_reg;
#endif
	uint32_t value;
#if defined(BOARD_ASIC)
	// power on/reset
	// 1.2V = 1, 1.8V = 1, 2.9V = 1
	// INCK on
	// set the vip to full speec
	writel(0x0A0C8030, 0x21084210);
	writel(0x0A0C8034, 0x00084210);
	// select the source of mac0 to vip_sys_2
	value = readl(0x0a0c801C);
	value &= ~(0x03<<8);
	value |= (0x2<<8);
	writel(0x0a0c801C, value);
	// set vip_sys_2 dividor
	writel(0x03002110, (2<<16)|0x09);
	// enable cam0pll clk source
	value = readl(0x03002030);
	value &= ~(1<<28);
	writel(0x03002030, value);
	// cam0pll dividor factor
	writel(0x030020F4, (CMA0PLL_CLK_DIV<<16)|0x09);
	// set sync source en
	value = readl(0x03002840);
	value |= (1<<4);
	writel(0x03002840, value);
	// set sync set
	writel(0x03002874, CAM0PLL_SYNC_SET);
	// set sync set sw up
	value = readl(0x03002870);
	value ^= 0x01;
	writel(0x03002870, value);
	// set csr
	value = CAM0PLL_PRE_DIV_SEL | (CAM0PLL_POST_DIV_SEL << 8) | (CAM0PLL_SEL_MODE << 15) | (CAM0PLL_DIV_SEL << 17)
		| (CAM0PLL_ICTRL << 24);
	writel(0x03002814, value);
	// clear pwd
	value = readl(0x03002800);
	value &= ~(1<<12);
	writel(0x03002800, value);
	udelay(100);
	// XCLR = 0
	writel(HARD_REG_GPIOD7_DAT, 0x00);
	writel(HARD_REG_GPIOD7_OE, 0x80);
	// wait 500ns, wait INCK stable
	udelay(1);
	// XCLR = 1
	writel(HARD_REG_GPIOD7_DAT, 0x80);
	// wait 20us
	udelay(20);
#endif

#if !defined(FLOW_AFTER_ECO)
	// enable display clk select
	value = readl(0x0a0c8018);
	value |= 0x02;
	writel(0x0a0c8018, value);
	udelay(5000);
#endif

	// Switch the MAC type to MIPI-CSI
	writel(0x0a0c4000, 0x000000F0);
	value = readl(0x0a0c4400);
	// config lane number
	value |= 0x03;
	// config force video format
	// value |= (0x8<<16) | (0x01<<13);
	// Enable SOL
	//value |= (0x1<<12);
	writel(0x0a0c4400, value);
	// config the vs gen mode.
	writel(0x0a0c4470, 0x00);
#if !defined(FLOW_AFTER_ECO)
	fpga_pwr_reg = (unsigned int *)HARD_REG_FPGA_PWRPIN;
	// power sequence
	writel(fpga_pwr_reg, 0);
	uartlog("power-on delay\n");
	udelay(5000);
	writel(fpga_pwr_reg, 0x08);
	uartlog("power-on delay\n");
	udelay(5000);
	writel(fpga_pwr_reg, 0x18);
	uartlog("power-on delay\n");
	udelay(5000);
	writel(fpga_pwr_reg, 0x38);
	uartlog("power-on delay\n");
	udelay(5000);
	// clear reset and enable phy rx
	writel(fpga_pwr_reg, 0x32100039);
#endif
	uartlog("### device poweron\n");

	return 0;
}

int peri_down_os08a20_slave(void *priv)
{
	char cmdbuf[8] = {0};

	cli_readline("### power-off? y/n", cmdbuf);

	if (cmdbuf[0] == 'y') {
#if !defined(FLOW_AFTER_ECO)
		unsigned int *fpga_pwr_reg;

		fpga_pwr_reg = (unsigned int *)HARD_REG_FPGA_PWRPIN;
		// INCLK = 0
		// XCLR = 0
		// POWER-OFF sequence
		uartlog("power-off");
		writel(fpga_pwr_reg, 0x18);
		udelay(5000);
		writel(fpga_pwr_reg, 0x08);
		udelay(5000);
		writel(fpga_pwr_reg, 0);
		udelay(5000);
#endif
	}

	return 0;
}

