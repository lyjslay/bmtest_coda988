#include <stdlib.h>
#include <stdint.h>
#include <stdio.h>
#include <string.h>
#include <stdbool.h>
#include <stdarg.h>

#ifdef ENV_HOSTPC
#include <stdint.h>
#include <stdio.h>
#include <unistd.h>
#include "cli/command.h"
#include "cli/cli.h"
#else
#include "command.h"
#include "cli.h"
#include "system_common.h"
#include "module_testcase.h"
#include "uart.h"
#include "timer.h"
#endif


#include "../vip/reg.h"
#include "../vip/scaler.h"
#include "../vip/dwa.h"
#include "../vip/testcase_sclr.h"
#include "inc/isp_reg.h"
#include "isp_drv.h"

#include "sensorlist.h"
#include "patterns.h"
#include "../vip/vip_common.h"

#include "uapi/cvi_vip_tun_cfg.h"
#include "isp_tun_data.h"

#define DCI_LUT_UPDATE_INTERVAL 30

/********************************************************************
 *   externtal
 ********************************************************************/

extern int cli_readline(char *prompt, char *cmdbuf);
extern void sclmgr_from_isp(u8 inst, uint32_t in_w, uint32_t in_h, uint32_t out_w, uint32_t out_h, u64 addr0, u64 addr1, u64 addr2);

/********************************************************************
 *   local
 ********************************************************************/
enum CFG_OP {
    CFG_OP_WBG = 0,
    CFG_OP_BLC,
    CFG_OP_DPC,
    CFG_OP_FUSION,
    CFG_OP_LTM,
    CFG_OP_BNR,
    CFG_OP_RGB_PROB = 10,
    CFG_OP_RGB_EE,
    CFG_OP_GAMMA,
    CFG_OP_DHZ,
    CFG_OP_HSV,
    CFG_OP_RGB_DITHER,
    CFG_OP_444_422 = 20,
    CFG_OP_YUV_DITHER,
    CFG_OP_YNR,
    CFG_OP_CNR,
    CFG_OP_YCUR,
    CFG_OP_DCI = 25,
    CFG_OP_GE_TUN_CFG,
    CFG_OP_GAMMA_TUN_CFG,
    CFG_OP_EE_TUN_CFG,
    CFG_OP_DMA_RING_BUFFER,
    CFG_OP_MAX,
};

uint16_t gamma_data[] = {
0,120,220,310,390,470,540,610,670,730,786,842,894,944,994,1050,1096,1138,1178,
1218,1254,1280,1314,1346,1378,1408,1438,1467,1493,1519,1543,1568,1592,1615,1638,
1661,1683,1705,1726,1748,1769,1789,1810,1830,1849,1869,1888,1907,1926,1945,1963,
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4003,4010,4018,4025,4032,4039,4046,4054,4061,4068,4075,4082,4089,4095
};

uint16_t af_gamma_data[] = {
   0,   20,   28,   33,   38,   42,   46,   49,   52,   55,   58,   61,   63,   66,   68,   70, 
  72,   74,   76,   78,   80,   82,   83,   85,   87,   88,   90,   92,   93,   95,   96,   98, 
  99,  100,  102,  103,  104,  106,  107,  108,  110,  111,  112,  113,  114,  116,  117,  118, 
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 248,  249,  249,  250,  250,  250,  251,  251,  252,  252,  253,  253,  254,  254,  255,  255, 
 255
};

uint16_t hsv_sgain_data[] = {
128,128,128,128,128,128,128,128,128,128,128,128,128,128,128,128,
128,128,128,128,128,128,128,128,128,128,128,128,128,128,128,128,
128,128,128,128,128,128,128,128,128,128,128,128,128,128,128,128,
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128,
};

uint16_t hsv_vgain_data[] = {
128,128,128,128,128,128,128,128,128,128,128,128,128,128,128,128,
128,128,128,128,128,128,128,128,128,128,128,128,128,128,128,128,
128,128,128,128,128,128,128,128,128,128,128,128,128,128,128,128,
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128,
};

uint16_t hsv_htune_data[] = {
   0,   15,   30,   46,   62,   78,   95,  112,  129,  147,  165,  183,  201,  220,  239,  259,
 279,  299,  319,  340,  360,  381,  403,  425,  446,  469,  491,  514,  537,  560,  583,  607,
 631,  655,  679,  704,  729,  754,  779,  804,  830,  856,  882,  908,  935,  961,  988, 1015,
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24575,
};

uint16_t hsv_stune_data[] = {
   0,   10,   20,   31,   41,   52,   62,   72,   83,   93,  104,  114,  124,  135,  145,  156,
 166,  176,  187,  197,  208,  218,  228,  239,  249,  260,  270,  280,  291,  301,  312,  322,
 332,  343,  353,  364,  374,  384,  395,  405,  416,  426,  436,  447,  457,  468,  478,  488,
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5325,
};

uint16_t ycur_data[] = {
  0,    4,    8,   12,   16,   20,   24,   28,   32,   36,   40,   44,   48,   52,   56,   60,
 64,   68,   72,   76,   80,   84,   88,   92,   96,  100,  104,  108,  112,  116,  120,  124,
128,  132,  136,  140,  144,  148,  152,  156,  160,  164,  168,  172,  176,  180,  184,  188,
192,  196,  200,  204,  208,  212,  216,  220,  224,  228,  232,  236,  240,  244,  248,  252,
1023,
};

uint16_t ltm_d_lut[] = {
   0,  172,  317,  422,  489,  538,  581,  622,  661,  697,  731,  764,  795,  826,  854,  881,
 907,  932,  957,  980, 1004, 1027, 1050, 1072, 1093, 1112, 1129, 1146, 1163, 1180, 1197, 1214,
1230, 1247, 1263, 1279, 1295, 1311, 1327, 1343, 1358, 1373, 1389, 1404, 1419, 1433, 1448, 1463,
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4001,
};

uint16_t ltm_b_lut[] = {
   0,  115,  230,  346,  458,  575,  694,  813,  927, 1033, 1129, 1211, 1275, 1321, 1363, 1402,
1438, 1473, 1505, 1536, 1565, 1592, 1617, 1641, 1663, 1684, 1703, 1722, 1739, 1755, 1771, 1786,
1800, 1813, 1827, 1840, 1853, 1866, 1879, 1891, 1904, 1916, 1928, 1940, 1951, 1963, 1974, 1986,
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4095,
};

uint16_t ltm_g_lut[] = {
   0,   48,   96,  142,  187,  231,  273,  313,  352,  389,  425,  458,  490,  520,  549,  577,
 605,  632,  659,  686,  714,  741,  769,  796,  824,  851,  878,  905,  932,  959,  986, 1013,
1039, 1066, 1092, 1118, 1144, 1170, 1196, 1222, 1247, 1272, 1297, 1322, 1347, 1371, 1395, 1420,
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4095,
};

uint16_t dci_lut0[] = {
    1,   2,   2,   3,   4,   5,   6,   7,   8,   9,   11,  12,  13,  14,  15,  16,
    17,  18,  19,  19,  20,  21,  22,  23,  24,  24,  25,  26,  27,  28,  28,  29,
    30,  30,  31,  32,  32,  33,  33,  34,  34,  35,  35,  36,  36,  37,  37,  37,
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    254, 254, 254, 255, 255, 255, 255, 255, 255, 255, 255, 255, 255, 255, 255, 255,
};

uint16_t dci_lut1[256] = {};

uint16_t lscr_lut[] = {
512,   521,  541,  570,  620,  688,  767,  866,
985,  1147, 1340, 1551, 1802, 2102, 2463, 2842,
3304, 3886, 4095, 4095, 4095, 4095, 4095, 4095,
4095, 4095, 4095, 4095, 4095, 4095, 4095, 4095,
};

// for 2688*1944
uint64_t    bayer_r_addr[2] = {BASE_OFFSET + 0x110000000, BASE_OFFSET + 0x110800000};
uint64_t    bayer_w_addr[2] = {BASE_OFFSET + 0x111000000, BASE_OFFSET + 0x111800000};
uint64_t    yuv_addr[2] = {BASE_OFFSET + 0x112000000, BASE_OFFSET + 0x112800000};
uint64_t    tdnr_addr[2] = {BASE_OFFSET + 0x113000000, BASE_OFFSET + 0x113800000};
uint64_t    rgbmap_addr[2] = {BASE_OFFSET + 0x115000000, BASE_OFFSET + 0x115100000};
uint64_t    lmap_addr[2] = {BASE_OFFSET + 0x115200000, BASE_OFFSET + 0x115300000};
uint64_t    manr_addr = {BASE_OFFSET + 0x115400000};
uint64_t    lsc_addr[4] = {BASE_OFFSET + 0x115500000, BASE_OFFSET + 0x115520000,
			   BASE_OFFSET + 0x11540000, BASE_OFFSET + 0x115560000};
uint64_t    sts_addr[2] = {BASE_OFFSET + 0x115700000, BASE_OFFSET + 0x115800000};
uint64_t    dci_addr = {BASE_OFFSET + 0x115900000};
uint64_t    tdnr_rtile_addr[2] = {BASE_OFFSET + 0x116000000, BASE_OFFSET + 0x116800000};
uint64_t    yuv422_addr[3] = {BASE_OFFSET + 0x117000000, BASE_OFFSET + 0x117800000, BASE_OFFSET + 0x118000000};

static bool is_dci_enable = false;
static bool is_raw_dump = false;
static bool is_yuv_dump = false;
struct dump_mem {
    uint64_t addr_start;
    uint64_t addr_end;
    uint64_t offset;
    uint32_t size;
} dump_le, dump_se, dump_yuv;

struct vip_rect crop0, crop1;
uint64_t post_y_addr, post_u_addr, post_v_addr;
struct isp_dhz_cfg dhz_cfg = {
    .strength = 30,
    .th_smooth = 200,
    .cum_th = 1024,
    .hist_th = 512,
    .tmap_max = 8191,
    .tmap_min = 819,
    .sw_dc_th = 1000,
    .sw_aglobal = 3840,
    .sw_dc_trig = 0,
};

/********************************************************************
 *   API
 ********************************************************************/

static int patgen_start(void *);
static int patgen_stop(void *);
static int patgen_isppath_start(void *);
static int patgen_isppath_stop(void *);
static int memin_start(void *priv);
static int memin_stop(void *priv);

static int isp_isr(void *priv);

static int pattern_isp_flow_patgen2dram(void *);
static int pattern_isp_flow_patgen2dram_cmdq(void *);
static int pattern_isp_flow_manual(void *);
static int pattern_isp_flow_dram2dram(void *);
static int pattern_isp_dma_patgen2dram(void *);
static int pattern_isp_hdr_csi2dram(void *priv);
static int isp_test_post_m2m(void *priv);
#ifdef VIP_PERFORMANCE_TEST
struct fb_param {
    u32 width;
    u32 height;
    u16 offset_x;
    u16 offset_y;
};

static int isp_test_vip_stress(void *priv);
static void try_trig_next_frame(void);
extern void dwa_package_cfg(u8 format, bool out_2_mem, struct fb_param *src_fb, struct fb_param *dst_fb, u64 *src_addrs, u64 *dst_addrs, u64 mesh_addr, struct dwa_cfg *cfg);
extern void enable_disp2k_for_test(void);

static cb_func stress_cb = NULL;
static struct dwa_cfg dwa_cfg;
static bool dwa_frame_done = false;
static bool sc_frame_done = false;
static volatile union sclr_intr sc_intr_mask;
static u8 cb_mask;
static u8 mod_mask;
#endif

static struct isp_ctx m_ispctx;

static pattern_ctx m_ptn_ctx = {
    .vreg_bases = NULL,
    .vreg_bases_pa = NULL,
    .phys_regs  = NULL,
    .mem_base   = DRAM_PHY_BASE,
    .alloc_size = 0,
    .alloc_cnt  = 0,
    .is_offline_preraw = 0,
    .is_offline_postraw = 0,
    .is_offline_scaler = 1,
    .is_stop = 0,
    .ptn        = NULL,
};

static pattern_entry pattern_db[] = {
    {
        .name = "isp_flow_manual",
        .priv = &m_ispctx,
        .config_op = pattern_isp_flow_manual,
        .start_op = patgen_isppath_start,
        .stop_op = patgen_isppath_stop,
        .verify_op = NULL,
        .intr_op = isp_isr,
    },
    {
        .name = "isp_flow_patgen2dram",
        .priv = NULL,
        .config_op = pattern_isp_flow_patgen2dram,
        .start_op = patgen_start,
        .stop_op = patgen_stop,
        .verify_op = NULL,
        .intr_op = isp_isr,
    },
    {
        .name = "isp_flow_patgen2dram_cmdq",
        .priv = NULL,
        .config_op = pattern_isp_flow_patgen2dram_cmdq,
        .start_op = patgen_start,
        .stop_op = patgen_stop,
        .verify_op = NULL,
        .intr_op = isp_isr,
    },
    {
        .name = "isp_flow_dram2dram",
        .priv = NULL,
        .config_op = pattern_isp_flow_dram2dram,
        .start_op = memin_start,
        .stop_op = memin_stop,
        .verify_op = NULL,
        .intr_op = isp_isr,
    },
    {
        .name = "isp_dma_patgen2dram",
        .priv = NULL,
        .config_op = pattern_isp_dma_patgen2dram,
        .start_op = patgen_start,
        .stop_op = patgen_stop,
        .verify_op = NULL,
        .intr_op = isp_isr,
    },
    {
        .name = "isp_hdr_csi2dram",
        .priv = NULL,
        .config_op = pattern_isp_hdr_csi2dram,
        .start_op = patgen_start,
        .stop_op = patgen_stop,
        .verify_op = NULL,
        .intr_op = isp_isr,
    },
    {
        .name = "isp_post_m2m",
        .priv = NULL,
        .config_op = isp_test_post_m2m,
        .start_op = NULL,
        .stop_op = NULL,
        .verify_op = NULL,
        .intr_op = NULL,
    },
#ifdef VIP_PERFORMANCE_TEST
    {
        .name = "vip_stress",
        .priv = &m_ispctx,
        .config_op = isp_test_vip_stress,
        .start_op = patgen_isppath_start,
        .stop_op = patgen_isppath_stop,
        .verify_op = NULL,
        .intr_op = isp_isr,
    },
#endif
    {
        .name = "END",
        .priv = NULL,
        .config_op = NULL,
    }
};

static s16 frame_count = 100;

#undef uartlog
#define uartlog(fmt, args...) \
{ \
    printf(fmt, ##args); \
    fflush(stdout); \
}

static void raw_dump_reset(void)
{
    is_raw_dump = false;
    dump_le.addr_start = 0x120000000;
    dump_le.addr_end   = 0x190000000;
    dump_le.offset     = 0;
    dump_le.size       = 0;
    dump_se.addr_start = 0x190000000;
    dump_se.addr_end   = 0x200000000;
    dump_se.offset     = 0;
    dump_se.size       = 0;
}

/*
 * @buf: 0(le), 1(se)
 */
static void _raw_dump_next_buf(struct isp_ctx *ictx, uint8_t buf)
{
    struct dump_mem *mem = (buf == 0) ? &dump_le : &dump_se;
    uint64_t addr = mem->addr_start + mem->offset;
    if (addr > mem->addr_end) {
	uartlog("raw dump address(0x%lx) over dram size(0x%lx)\n", addr, mem->addr_end);
	return;
    }
    uartlog("update raw dump address(0x%lx)\n", addr);
    if (buf == 0) {
	ispblk_dma_setaddr(ictx, ISP_BLK_ID_DMA0, addr);
	ispblk_dma_setaddr(ictx, ISP_BLK_ID_DMA6, addr);
    } else {
	ispblk_dma_setaddr(ictx, ISP_BLK_ID_DMA1, addr);
	ispblk_dma_setaddr(ictx, ISP_BLK_ID_DMA7, addr);
    }
    mem->offset += mem->size;
}

static void raw_dump_next_buf(struct isp_ctx *ictx)
{
    _raw_dump_next_buf(ictx, 0);
    if (ictx->is_hdr_on)
	_raw_dump_next_buf(ictx, 1);
}

static void yuv_dump_reset(void)
{
    is_yuv_dump = false;
    dump_yuv.addr_start = 0x120000000;
    dump_yuv.addr_end   = 0x190000000;
    dump_yuv.offset     = 0;
    dump_yuv.size       = 0;
}

static void yuv_dump_next_buf(struct isp_ctx *ictx)
{
    struct dump_mem *mem = &dump_yuv;
    uint64_t addr = mem->addr_start + mem->offset;
    uint32_t bufsize;

    if (addr > mem->addr_end) {
	uartlog("yuv dump address(0x%lx) over dram size(0x%lx)\n", addr, mem->addr_end);
	return;
    }

    uartlog("update y dump address(0x%lx)\n", addr);
    bufsize = ispblk_dma_config(ictx, ISP_BLK_ID_DMA3, addr);
    mem->offset += bufsize;

    addr = mem->addr_start + mem->offset;
    uartlog("update u dump address(0x%lx)\n", addr);
    bufsize = ispblk_dma_config(ictx, ISP_BLK_ID_DMA4, addr);
    mem->offset += bufsize;

    addr = mem->addr_start + mem->offset;
    uartlog("update v dump address(0x%lx)\n", addr);
    bufsize = ispblk_dma_config(ictx, ISP_BLK_ID_DMA5, addr);
    mem->offset += bufsize;
}

void isp_rawtop_update(struct isp_ctx *ictx)
{
    union REG_ISP_DPC_2 dpc_reg2;
    uint32_t    bufsize;
    uint64_t    bufaddr;

    ispblk_rawtop_config(ictx);

    if (ictx->is_yuv_sensor) {
	uint64_t lsc = ictx->phys_regs[ISP_BLK_ID_LSCM0];

	dpc_reg2.bits.DPC_ENABLE = 0;
	ispblk_dpc_config(ictx, ISP_RAW_PATH_LE, dpc_reg2);

	ispblk_blc_enable(ictx, ISP_BLC_ID_PRE0_LE, false, true);
	ispblk_blc_enable(ictx, ISP_BLC_ID_POST_LE, false, true);
	ISP_WR_REG(lsc, REG_ISP_LSC_T, LSC_ENABLE, false);
	isp_fpn_config(ictx, ISP_BLK_ID_FPN0, false);
    } else {
	dpc_reg2.bits.DPC_ENABLE = 1;
	dpc_reg2.bits.GE_ENABLE = 1;
	dpc_reg2.bits.DPC_DYNAMICBPC_ENABLE = 1;
	dpc_reg2.bits.DPC_STATICBPC_ENABLE = 1;
	dpc_reg2.bits.DPC_CLUSTER_SIZE = 2;
	ispblk_dpc_config(ictx, ISP_RAW_PATH_LE, dpc_reg2);

	ispblk_blc_enable(ictx, ISP_BLC_ID_PRE0_LE, true, true);
	ispblk_blc_enable(ictx, ISP_BLC_ID_POST_LE, true, true);
	ispblk_lsc_config(ictx, ISP_BLK_ID_LSCM0, false);
	isp_fpn_config(ictx, ISP_BLK_ID_FPN0, false);

	if (ictx->is_tile && ictx->is_work_on_r_tile) {
		bufsize = ispblk_dma_config(ictx, ISP_BLK_ID_DMA10, lsc_addr[1]);
		uartlog("Right tile addr for dma10(lsc le): 0x%lx, size: 0x%x\n", lsc_addr[1], bufsize);
	} else {
		bufsize = ispblk_dma_config(ictx, ISP_BLK_ID_DMA10, lsc_addr[0]);
		uartlog("addr for dma10(lsc le): 0x%lx, size: 0x%x\n", lsc_addr[0], bufsize);
	}
    }

	if (ictx->is_hdr_on) {
	    ispblk_dpc_config(ictx, ISP_RAW_PATH_SE, dpc_reg2);
	    ispblk_blc_enable(ictx, ISP_BLC_ID_PRE0_SE, true, true);
	    ispblk_blc_enable(ictx, ISP_BLC_ID_POST_SE, true, true);
	    ispblk_lsc_config(ictx, ISP_BLK_ID_LSCM1, false);
	    isp_fpn_config(ictx, ISP_BLK_ID_FPN1, false);

		if (ictx->is_tile && ictx->is_work_on_r_tile) {
			bufsize = ispblk_dma_config(ictx, ISP_BLK_ID_DMA11, lsc_addr[3]);
			uartlog("addr for dma10(lsc le): 0x%lx, size: 0x%x\n", lsc_addr[3], bufsize);
		} else {
			bufsize = ispblk_dma_config(ictx, ISP_BLK_ID_DMA11, lsc_addr[2]);
			uartlog("addr for dma10(lsc le): 0x%lx, size: 0x%x\n", lsc_addr[3], bufsize);
		}
	    ispblk_fusion_config(ictx, true, false, false, ISP_FS_OUT_FS);
	} else {
	    ispblk_fusion_config(ictx, true, true, true, ISP_FS_OUT_LONG);
	}

    if (ictx->is_hdr_on) {
	ispblk_ltm_b_lut(ictx, 0, ltm_b_lut);
	ispblk_ltm_d_lut(ictx, 0, ltm_d_lut);
	ispblk_ltm_g_lut(ictx, 0, ltm_g_lut);
	ispblk_ltm_config(ictx, true, true, true, true, 1, 1);
	ispblk_ltm_enable(ictx, true, false);
	uint64_t *phys_regs = ictx->phys_regs;
	#include "patterns/ltm_resize/register.cfg.h"
    } else {
	ispblk_ltm_config(ictx, false, false, false, false, 1, 1);
	ispblk_ltm_enable(ictx, true, true);
    }

    if (ictx->is_yuv_sensor) {
	ispblk_wbg_enable(ictx, ISP_WBG_ID_PRE0_LE, false, false);
	ispblk_wbg_enable(ictx, ISP_WBG_ID_POST_LE, false, false);
	ispblk_bnr_config(ictx, ISP_BNR_OUT_BYPASS, false, 0, 0);
    } else {
	ispblk_wbg_config(ictx, ISP_WBG_ID_PRE0_LE, 0x400, 0x400, 0x400);
	ispblk_wbg_enable(ictx, ISP_WBG_ID_PRE0_LE, true, false);
	ispblk_wbg_config(ictx, ISP_WBG_ID_POST_LE, 0x400, 0x400, 0x400);
	ispblk_wbg_enable(ictx, ISP_WBG_ID_POST_LE, true, false);
	ispblk_bnr_config(ictx, ISP_BNR_OUT_B_OUT, false, 0, 0);
    }

    ispblk_wbg_config(ictx, ISP_WBG_ID_POST_FS, 0x9c4, 0x400, 0x60e);
    ispblk_wbg_enable(ictx, ISP_WBG_ID_POST_FS, true, false);

    if (ictx->is_hdr_on) {
	ispblk_wbg_config(ictx, ISP_WBG_ID_PRE0_SE, 0x677, 0x400, 0x4B0);
	ispblk_wbg_enable(ictx, ISP_WBG_ID_PRE0_SE, true, false);
	ispblk_wbg_config(ictx, ISP_WBG_ID_POST_SE, 0x677, 0x400, 0x4B0);
	ispblk_wbg_enable(ictx, ISP_WBG_ID_POST_SE, true, false);
    }

    ispblk_manr_config(ictx, ictx->is_3dnr_on);
    if (ictx->is_3dnr_on) {
#if 0
    uint64_t *phys_regs;
    phys_regs = ctx->phys_regs;
    uartlog("JAMMY load manr\n");
    bufaddr = rgbmap_addr[0];
    #include "patterns/isp_manr/register.cfg.h"
#endif
	ispblk_dma_config(ictx, ISP_BLK_ID_DMA23, manr_addr);
	ispblk_dma_config(ictx, ISP_BLK_ID_DMA24, manr_addr);
	if (ictx->is_offline_postraw) {
	    ispblk_dma_config(ictx, ISP_BLK_ID_DMA19, rgbmap_addr[0]);
	    ispblk_dma_config(ictx, ISP_BLK_ID_DMA21, rgbmap_addr[0] + 0x80000);
	} else {
	    ispblk_dma_config(ictx, ISP_BLK_ID_DMA19, rgbmap_addr[0]);
	}
	if (ictx->is_hdr_on) {
	    ispblk_dma_config(ictx, ISP_BLK_ID_DMA20, rgbmap_addr[1]);
	    ispblk_dma_config(ictx, ISP_BLK_ID_DMA22, rgbmap_addr[1] + 0x80000);
	}

		if (ictx->is_tile && ictx->is_work_on_r_tile) {
			ispblk_dma_config(ictx, ISP_BLK_ID_DMA25, tdnr_rtile_addr[0]);
			ispblk_dma_config(ictx, ISP_BLK_ID_DMA27, tdnr_rtile_addr[0]);
			ispblk_dma_config(ictx, ISP_BLK_ID_DMA26, tdnr_rtile_addr[1]);
			ispblk_dma_config(ictx, ISP_BLK_ID_DMA28, tdnr_rtile_addr[1]);
		} else {
			ispblk_dma_config(ictx, ISP_BLK_ID_DMA25, tdnr_addr[0]);
			ispblk_dma_config(ictx, ISP_BLK_ID_DMA27, tdnr_addr[0]);
			ispblk_dma_config(ictx, ISP_BLK_ID_DMA26, tdnr_addr[1]);
			ispblk_dma_config(ictx, ISP_BLK_ID_DMA28, tdnr_addr[1]);
		}
    }

    if (ictx->is_yuv_sensor) {
	bufaddr = yuv422_addr[0];
	bufsize = ispblk_dma_config(ictx, ISP_BLK_ID_DMA0, bufaddr);
	ispblk_dma_config(ictx, ISP_BLK_ID_DMA59, bufaddr);
	uartlog("bayer addr for dma0(pre0)/59(yuv): 0x%lx 0x%x\n", bufaddr, bufsize);

	bufaddr = yuv422_addr[1];
	bufsize = ispblk_dma_config(ictx, ISP_BLK_ID_DMA1, bufaddr);
	ispblk_dma_config(ictx, ISP_BLK_ID_DMA60, bufaddr);
	uartlog("bayer addr for dma1(pre0)/60(yuv): 0x%lx 0x%x\n", bufaddr, bufsize);

	bufaddr = yuv422_addr[2];
	bufsize = ispblk_dma_config(ictx, ISP_BLK_ID_DMA2, bufaddr);
	ispblk_dma_config(ictx, ISP_BLK_ID_DMA61, bufaddr);
	uartlog("bayer addr for dma2(pre0)/61(yuv): 0x%lx 0x%x\n", bufaddr, bufsize);
    } else {
	if (ictx->is_offline_postraw) {
	    bufaddr = bayer_w_addr[0];
	    bufsize = ispblk_dma_config(ictx, ISP_BLK_ID_DMA0, bufaddr);
	    ispblk_dma_config(ictx, ISP_BLK_ID_DMA6, bufaddr);
	    uartlog("bayer addr for dma0(pre0)/6(post crop0): 0x%lx 0x%x\n", bufaddr, bufsize);
	    dump_le.size = bufsize;

	    ispblk_dma_enable(ictx, ISP_BLK_ID_DMA0, 1);
	    ispblk_dma_enable(ictx, ISP_BLK_ID_DMA6, 1);
	} else {
	    ispblk_dma_enable(ictx, ISP_BLK_ID_DMA0, 0);
	    ispblk_dma_enable(ictx, ISP_BLK_ID_DMA6, 0);
	}

	if (ictx->is_hdr_on) {
	    bufaddr = bayer_w_addr[1];
	    bufsize = ispblk_dma_config(ictx, ISP_BLK_ID_DMA1, bufaddr);
	    ispblk_dma_config(ictx, ISP_BLK_ID_DMA7, bufaddr);
	    uartlog("bayer addr for dma1(pre1)/dma7(post crop1): 0x%lx 0x%x\n", bufaddr, bufsize);
	    dump_se.size = bufsize;

	    ispblk_dma_enable(ictx, ISP_BLK_ID_DMA1, 1);
	    ispblk_dma_enable(ictx, ISP_BLK_ID_DMA7, 1);
	} else {
	    ispblk_dma_enable(ictx, ISP_BLK_ID_DMA1, 0);
	    ispblk_dma_enable(ictx, ISP_BLK_ID_DMA7, 0);
	}
    }
}

void isp_rgbtop_update(struct isp_ctx *ictx)
{
	struct isp_ccm_cfg ccm_data;

	ccm_data.coef[0][0] = 0x200;
	ccm_data.coef[0][1] = 0x201;
	ccm_data.coef[0][2] = 0x202;
	ccm_data.coef[1][0] = 0x400;
	ccm_data.coef[1][1] = 0x401;
	ccm_data.coef[1][2] = 0x402;
	ccm_data.coef[2][0] = 0x800;
	ccm_data.coef[2][1] = 0x801;
	ccm_data.coef[2][2] = 0x802;

    if (!ictx->is_yuv_sensor) {
	ispblk_rgb_config(ictx);
	ispblk_cfa_config(ictx);
	ispblk_rgbee_config(ictx, true, 358, 310);
	ispblk_ccm_config(ictx, false, &ccm_data);
	ispblk_gamma_config(ictx, 0, gamma_data);
	ispblk_gamma_enable(ictx, false, 0);
	ispblk_dhz_config(ictx, true, &dhz_cfg);
	ispblk_hsv_config(ictx, 0, 0, hsv_sgain_data);
	ispblk_hsv_config(ictx, 0, 1, hsv_vgain_data);
	ispblk_hsv_config(ictx, 0, 2, hsv_htune_data);
	ispblk_hsv_config(ictx, 0, 3, hsv_stune_data);
	ispblk_hsv_enable(ictx, false, 0, true, true, true, true);
	// TODO: disable dither to avoid effect tile
	if (ictx->is_tile)
	    ispblk_rgbdither_config(ictx, false, true, true, true);
	else
	    ispblk_rgbdither_config(ictx, true, true, true, true);
	ispblk_csc_config(ictx);
    }
}

void isp_yuvtop_update(struct isp_ctx *ictx)
{
    uint32_t    bufsize;
    uint64_t    bufaddr;

    ispblk_yuvtop_config(ictx);
    // TODO: disable dither to avoid effect tile
    if (ictx->is_tile) {
	ispblk_yuvdither_config(ictx, 0, false, true, true, true);
	ispblk_yuvdither_config(ictx, 1, false, true, true, true);
    } else {
	ispblk_yuvdither_config(ictx, 0, true, true, true, true);
	ispblk_yuvdither_config(ictx, 1, true, true, true, true);
    }
    ispblk_444_422_config(ictx);
    ispblk_ynr_config(ictx, ISP_YNR_OUT_Y_OUT, 16, 0);
    ispblk_cnr_config(ictx, true, true, 32);

    if (ictx->is_tile && ictx->is_work_on_r_tile)
        ispblk_dci_config(ictx, true, dci_lut1, ARRAY_SIZE(dci_lut1));
    else
        ispblk_dci_config(ictx, true, dci_lut0, ARRAY_SIZE(dci_lut0));
    ispblk_dma_config(ictx, ISP_BLK_ID_DMA36, dci_addr);

    ispblk_ee_config(ictx, true, false);
    ispblk_ycur_config(ictx, 0, ycur_data);
    ispblk_ycur_enable(ictx, false, 0);

    ispblk_3dlut_config(ictx);

    if (ictx->is_offline_scaler) {
	// setup dma for postraw yuv
	//bufsize = ictx->img_width * ictx->img_height;
	//bufaddr = PTN_MALLOC(bufsize, ctx);
	bufaddr = yuv_addr[0];
	if (ictx->is_tile && ictx->is_work_on_r_tile) {
	    bufsize = ispblk_dma_config(ictx, ISP_BLK_ID_DMA3, bufaddr + ictx->tile_cfg.r_out.start);
	    uartlog("y buf addr for dma3: 0x%lx, size: 0x%x\n", bufaddr + ictx->tile_cfg.r_out.start, bufsize);
	} else {
	    bufsize = ispblk_dma_config(ictx, ISP_BLK_ID_DMA3, bufaddr);
	    uartlog("y buf addr for dma3: 0x%lx, size: 0x%x\n", bufaddr, bufsize);
	}
	post_y_addr = bufaddr;

	//bufsize = VIP_ALIGN(ictx->img_width/2) * ictx->img_height/2;
	//bufaddr = PTN_MALLOC(bufsize, ctx);
	bufaddr += bufsize;
	if (ictx->is_tile && ictx->is_work_on_r_tile) {
	    bufsize = ispblk_dma_config(ictx, ISP_BLK_ID_DMA4, bufaddr + (ictx->tile_cfg.r_out.start >> 1));
	    uartlog("u buf addr for dma4: 0x%lx, size: 0x%x\n", bufaddr + (ictx->tile_cfg.r_out.start >> 1), bufsize);
	} else {
	    bufsize = ispblk_dma_config(ictx, ISP_BLK_ID_DMA4, bufaddr);
	    uartlog("u buf addr for dma4: 0x%lx, size: 0x%x\n", bufaddr, bufsize);
	}
	post_u_addr = bufaddr;

	//bufaddr = PTN_MALLOC(bufsize, ctx);
	bufaddr += bufsize;
	if (ictx->is_tile && ictx->is_work_on_r_tile) {
	    bufsize = ispblk_dma_config(ictx, ISP_BLK_ID_DMA5, bufaddr + (ictx->tile_cfg.r_out.start >> 1));
	    uartlog("v buf addr for dma5: 0x%lx, size: 0x%x\n", bufaddr + (ictx->tile_cfg.r_out.start >> 1), bufsize);
	} else {
	    bufsize = ispblk_dma_config(ictx, ISP_BLK_ID_DMA5, bufaddr);
	    uartlog("v buf addr for dma5: 0x%lx, size: 0x%x\n", bufaddr, bufsize);
	}
	post_v_addr = bufaddr;


	ispblk_dma_enable(ictx, ISP_BLK_ID_DMA3, 1);
	ispblk_dma_enable(ictx, ISP_BLK_ID_DMA4, 1);
	ispblk_dma_enable(ictx, ISP_BLK_ID_DMA5, 1);
    } else {
	ispblk_dma_enable(ictx, ISP_BLK_ID_DMA3, 0);
	ispblk_dma_enable(ictx, ISP_BLK_ID_DMA4, 0);
	ispblk_dma_enable(ictx, ISP_BLK_ID_DMA5, 0);

#ifdef VIP_INC_ISP
	uartlog("----please start config sc----\n");
#else
	uint32_t    out_w, out_h;
	out_w = ictx->img_width;
	out_h = ictx->img_height;
	uartlog("scaling (%d,%d) => (%d,%d)\n", ictx->img_width, ictx->img_height, out_w, out_h);

	bufsize = out_w * out_h;

	//scaler output rgb
	uint64_t    bufaddr0, bufaddr1, bufaddr2;
	bufaddr0 = PTN_MALLOC(bufsize, ctx);
	bufaddr1 = PTN_MALLOC(bufsize, ctx);
	bufaddr2 = PTN_MALLOC(bufsize, ctx);
	uartlog("sc addr (0x%lx, 0x%lx, 0x%lx)\n", bufaddr0, bufaddr1, bufaddr2);
	sclmgr_from_isp(0, ictx->img_width, ictx->img_height, out_w, out_h, bufaddr0, bufaddr1, bufaddr2);
#endif //VIP_INC_ISP
    }
}

static void _left_tile(struct isp_ctx *ictx)
{
    struct vip_rect crop = crop0;

    ictx->is_work_on_r_tile = 0;
    crop = crop0;
    crop.w = ictx->tile_cfg.l_in.end - ictx->tile_cfg.l_in.start + 1;
    ictx->img_width = crop.w;

    // for input
    ispblk_crop_config(ictx, ISP_BLK_ID_CROP2, crop);
    if (ictx->is_hdr_on) {
	ispblk_crop_config(ictx, ISP_BLK_ID_CROP3, crop);
    }

    // for output
    memset(&crop, 0, sizeof(crop));
    crop.h = crop0.h;
    crop.w = ictx->tile_cfg.l_out.end - ictx->tile_cfg.l_out.start + 1;
    ispblk_crop_config(ictx, ISP_BLK_ID_CROP4, crop);
    crop.w >>= 1;
    crop.h >>= 1;
    ispblk_crop_config(ictx, ISP_BLK_ID_CROP5, crop);
    ispblk_crop_config(ictx, ISP_BLK_ID_CROP6, crop);

    isp_rawtop_update(ictx);
    isp_rgbtop_update(ictx);
    isp_yuvtop_update(ictx);
}

static void _right_tile(struct isp_ctx *ictx)
{
    struct vip_rect crop = crop0;

    ictx->is_work_on_r_tile = 1;
    crop = crop0;
    crop.x += ictx->tile_cfg.r_in.start;
    crop.w = ictx->tile_cfg.r_in.end - ictx->tile_cfg.r_in.start + 1;
    ictx->img_width = crop.w;

    // for input
    ispblk_crop_config(ictx, ISP_BLK_ID_CROP2, crop);
    if (ictx->is_hdr_on) {
	ispblk_crop_config(ictx, ISP_BLK_ID_CROP3, crop);
    }

    // for output
    memset(&crop, 0, sizeof(crop));
    crop.h = crop0.h;
    crop.x = ictx->tile_cfg.r_out.start - ictx->tile_cfg.r_in.start;
    crop.w = ictx->tile_cfg.r_out.end - ictx->tile_cfg.r_out.start + 1;
    ispblk_crop_config(ictx, ISP_BLK_ID_CROP4, crop);
    crop.x >>= 1;
    crop.y >>= 1;
    crop.w >>= 1;
    crop.h >>= 1;
    ispblk_crop_config(ictx, ISP_BLK_ID_CROP5, crop);
    ispblk_crop_config(ictx, ISP_BLK_ID_CROP6, crop);

    isp_rawtop_update(ictx);
    isp_rgbtop_update(ictx);
    isp_yuvtop_update(ictx);
}

static void _dci_lut_update(struct isp_ctx *ictx)
{
    struct dci_param param;
    param.cliplimit_sel = 100;
    param.strecth_th_0 = 60;
    param.strecth_th_1 = 200;
    param.strecth_strength_0 = 256;
    param.strecth_strength_1 = 256;

    uint16_t *dci_lut = (ictx->is_tile && ictx->is_work_on_r_tile)
		      ? dci_lut1 : dci_lut0;

    ispblk_dci_hist_gen((u8*)dci_addr, dci_lut);
    ispblk_dci_lut_gen(ictx, dci_lut, &param);
}

int list_pattern(void)
{
    int i;

    uartlog("=======================================\n");
    uartlog("            Pattern List\n");
    uartlog("=======================================\n");
    for (i = 0; i < ARRAY_SIZE(pattern_db); ++i) {
        if (pattern_db[i].config_op == NULL) {
            break;
        }
        uartlog("%02d. %s\n", i, pattern_db[i].name);
    }
    uartlog("---------------------------------------\n");

    return 0;
}

pattern_ctx* create_pattern_ctx(int case_num)
{
    if ((case_num >= ARRAY_SIZE(pattern_db)) || (pattern_db[case_num].config_op == NULL)) {
        uartlog("%s:%d: error: invalid input %d\n", __func__, __LINE__, case_num);
        return NULL;
    }

    uartlog("%s ............\n", __func__);

    m_ptn_ctx.phys_regs = NULL;
    m_ptn_ctx.mem_base = DRAM_PHY_BASE;
    m_ptn_ctx.vreg_bases = NULL;
    m_ptn_ctx.vreg_bases_pa = NULL;
    m_ptn_ctx.alloc_size = 0;
    m_ptn_ctx.alloc_cnt = 0;

    m_ptn_ctx.is_offline_preraw = 0;
    m_ptn_ctx.is_offline_postraw = 0;
    m_ptn_ctx.is_offline_scaler = 1;
    m_ptn_ctx.is_stop = 1;
    m_ptn_ctx.is_pre0_frame_done = 0;
    m_ptn_ctx.is_pre1_frame_done = 0;
    m_ptn_ctx.is_post_frame_done = 1;
    memset((void *)&m_ptn_ctx.rc, 0, sizeof(m_ptn_ctx.rc));

    m_ptn_ctx.ptn = &pattern_db[case_num];

    return &m_ptn_ctx;
}

void destroy_pattern_ctx(pattern_ctx *ctx)
{
    uartlog("%s ............\n", __func__);

    PTN_FREE_ALL(ctx);
}

/**
 *   when to trig sclr manually.
 *   O(online) X(offline)
 *   preraw ->  postraw ->  sclr  |  tirg-sc
 *          X           X              when postraw frame-done
 *          O           X              when postraw frame-doen
 *          X           O              when preraw frame-doen to trig postraw
 *          O           O              no need, take csi vsync to start.
 */
static int isp_isr(void *priv)
{
    pattern_ctx *ctx = (pattern_ctx *)priv;
    struct isp_ctx *ictx = ctx->ptn->priv;
    uint64_t csi_bdg0, preraw0;
    static u64 now, prev, last_end;
    bool kick_pre0 = 0, kick_pre1 = 0;
    union isp_intr isp_status;
    union isp_csi_intr csi_status;
    uint64_t isp_top;

    now = timer_get_tick();

    csi_bdg0 = ctx->phys_regs[ISP_BLK_ID_CSIBDG0];
    preraw0 = ctx->phys_regs[ISP_BLK_ID_PRERAW0];
    isp_top = ctx->phys_regs[ISP_BLK_ID_ISPTOP];

    u8 frame_vld_pre0 = (ISP_RD_BITS(preraw0, REG_PRE_RAW_T, FRAME_VLD, PRE_RAW_FRAME_VLD));
    isp_status = isp_intr_status(ictx);
    csi_status = isp_csi_intr_status(ictx);
    if (csi_status.bits.FIFO_OVERFLOW_INT) {
	isp_pchk_chk_status(ctx->ptn->priv, 0xf1, 0xFFFFFFFF);

	uartlog("csi_bdg rt_pxl_cnt(%d), rt_line_cnt(%d)\n",
	    ISP_RD_REG(csi_bdg0, REG_ISP_CSI_BDG_T, CSI_RT_INFO_PXL_CNT),
	    ISP_RD_REG(csi_bdg0, REG_ISP_CSI_BDG_T, CSI_RT_INFO_LINE_CNT));
	uartlog("csi_bdg ch0 no rspd cyc(%d)\n",
	    ISP_RD_REG(csi_bdg0, REG_ISP_CSI_BDG_T, CH0_NO_RSPD_CYC_CNT));
	if (ctx->is_offline_scaler) {
	    uint32_t bus_0, bus_1, bus_2, bus_3;
	    bus_0 = ispblk_dma_dbg_st(ictx, ISP_BLK_ID_DMA3, 0);
	    bus_1 = ispblk_dma_dbg_st(ictx, ISP_BLK_ID_DMA3, 1);
	    bus_2 = ispblk_dma_dbg_st(ictx, ISP_BLK_ID_DMA3, 2);
	    bus_3 = ispblk_dma_dbg_st(ictx, ISP_BLK_ID_DMA3, 3);
	    uartlog("dma3 dbus st(%#x %#x %#x %#x)\n", bus_0, bus_1, bus_2, bus_3);

	    bus_0 = ispblk_dma_dbg_st(ictx, ISP_BLK_ID_DMA4, 0);
	    bus_1 = ispblk_dma_dbg_st(ictx, ISP_BLK_ID_DMA4, 1);
	    bus_2 = ispblk_dma_dbg_st(ictx, ISP_BLK_ID_DMA4, 2);
	    bus_3 = ispblk_dma_dbg_st(ictx, ISP_BLK_ID_DMA4, 3);
	    uartlog("dma4 dbus st(%#x %#x %#x %#x)\n", bus_0, bus_1, bus_2, bus_3);

	    bus_0 = ispblk_dma_dbg_st(ictx, ISP_BLK_ID_DMA5, 0);
	    bus_1 = ispblk_dma_dbg_st(ictx, ISP_BLK_ID_DMA5, 1);
	    bus_2 = ispblk_dma_dbg_st(ictx, ISP_BLK_ID_DMA5, 2);
	    bus_3 = ispblk_dma_dbg_st(ictx, ISP_BLK_ID_DMA5, 3);
	    uartlog("dma5 dbus st(%#x %#x %#x %#x)\n", bus_0, bus_1, bus_2, bus_3);
	}
    }

    isp_intr_clr(ictx, isp_status);
    isp_csi_intr_clr(ictx, csi_status);

    if (ctx->is_stop) {
	uartlog(" intr before start?? top_st(0x%x) cbdg_st(0x%x) \n",
	    isp_status.raw, csi_status.raw);
	ISP_WR_BITS(isp_top, REG_ISP_TOP_T, REG_1, FRAME_START_PRE_EN, 0);
	ISP_WR_BITS(csi_bdg0, REG_ISP_CSI_BDG_T, CSI_INTERRUPT_CTRL, FRAME_DROP_INT_EN, 0);
	return 0;
    }

#if defined(VIP_PERFORMANCE_TEST)
    if (isp_status.bits.FRAME_START_PRE) {
        ctx->rc.sof_cnt[0]++;

	if (ctx->is_post_frame_done && !ctx->is_pre0_frame_done
	    && (ctx->rc.preraw_done_cnt[0] >= ctx->rc.postraw_proc_cnt)) {
	    ctx->is_post_frame_done = 0;

	    isp_post_trig(ictx);

	    if (mod_mask & BIT(VIP_STRESS_MOD_SC)) {
		sc_frame_done = false;
		sc_intr_mask.b.scl0_frame_end = 1;
		sc_intr_mask.b.scl1_frame_end = 1;
		sc_intr_mask.b.scl2_frame_end = 1;
		sc_intr_mask.b.scl3_frame_end = 1;
		sclr_trig_start(0);
		sclr_trig_start(1);
	    }

	    if (mod_mask & BIT(VIP_STRESS_MOD_DWA)) {
		dwa_frame_done = false;
		dwa_reset();
		dwa_init();
		dwa_engine(&dwa_cfg);
	    }

	    if (stress_cb && (cb_mask & BIT(VIP_STRESS_CB_TYPE_SOF)))
		stress_cb(VIP_STRESS_CB_TYPE_SOF);
	    else
		uartlog("### isp kick post/sc on sof\n");
	}
    }

    /* prerarw frm_done */
    if (isp_status.bits.FRAME_DONE_PRE) {
	ctx->is_pre0_frame_done = 1;
        ctx->rc.preraw_done_cnt[0]++;

	if (!ctx->is_stop)
	    kick_pre0 = 1;
	else
	    uartlog("csibdg closed, no kick frame_valid\n");
    }

    /* postraw frm_done */
    if (isp_status.bits.FRAME_DONE_POST) {
	ctx->is_post_frame_done = 1;
        ctx->rc.postraw_proc_cnt++;

	if (!ctx->is_stop)
	    kick_pre0 = 1;
	else
	    uartlog("csibdg closed, no kick frame_valid\n");
    }

    try_trig_next_frame();

    if (csi_status.bits.FIFO_OVERFLOW_INT) {
	if (stress_cb && (cb_mask & BIT(VIP_STRESS_CB_TYPE_CSIBDG_FIFO_OVERFLOW)))
	    stress_cb(VIP_STRESS_CB_TYPE_CSIBDG_FIFO_OVERFLOW);
    }

    if (csi_status.bits.FRAME_DROP_INT) {
	if (stress_cb && (cb_mask & BIT(VIP_STRESS_CB_TYPE_CSIBDG_FRAME_DROP)))
	    stress_cb(VIP_STRESS_CB_TYPE_CSIBDG_FRAME_DROP);
    }

    uartlog(" preraw_frame_vld(%d), top_st(0x%x) cbdg_st(0x%x) sof(%d) preraw(%d) postraw(%d)\n\n",
        frame_vld_pre0, isp_status.raw, csi_status.raw, ctx->rc.sof_cnt[0],
	ctx->rc.preraw_done_cnt[0], ctx->rc.postraw_proc_cnt);

    prev = now;

    return 0;
#endif

#if 0
    /* preraw shaw_up */
    if (isp_status.bits.SHAW_DONE_PRE) {
        if (!ctx->is_offline_preraw) {
            if (ISP_RD_BITS(csi_bdg, REG_ISP_CSI_BDG_T, CSI_CTRL, CSI_MODE) != 0) {
                //ISP_WR_BITS(isp_top, REG_ISP_TOP_T, REG_2, FRAME_VLD_PRE, 1);
                kick = 1;
            }
            else
                uartlog("csibdg closed, no kick frame_valid\n");
        }

        ctx->rc.sof_cnt[0]++;
    }

    /* preraw1 shaw_up */
    if (isp_status.bits.SHAW_DONE_PRE1) {
        ctx->rc.sof_cnt[1]++;
    }
#endif

    /* prerarw frm_done */
    if (isp_status.bits.FRAME_DONE_PRE) {
	ctx->is_pre0_frame_done = 1;
        ctx->rc.preraw_done_cnt[0]++;

	if (ctx->is_offline_postraw) {
	    uint64_t bufaddr = rgbmap_addr[0];

	    if (ctx->rc.preraw_done_cnt[0] & 0x01) bufaddr += 0x80000;
	    ispblk_dma_config(ictx, ISP_BLK_ID_DMA15, bufaddr);
	    if (ictx->is_hdr_on) {
		bufaddr = rgbmap_addr[1];
		if (ctx->rc.preraw_done_cnt[0] & 0x01) bufaddr += 0x80000;
		ispblk_dma_config(ictx, ISP_BLK_ID_DMA16, bufaddr);
	    }

	    uartlog("trig postraw...\n");
	    ctx->is_post_frame_done = 0;

	    if (ictx->is_tile) {
		_left_tile(ictx);
		uartlog("### left tile\n");
		isp_post_trig(ictx);
	    } else {
		if (!ctx->is_offline_scaler) {
		    uartlog("### SCALER + ");
		    sclr_trig_start(ctx->sc_inst);
		}
		isp_post_trig(ictx);
	    }
        }

        if (ctx->is_offline_preraw)
            uartlog("     frame time: %ld->%ld, %ld\n",
		    ctx->sw_trig_time/TIMER_CNT_MS, now/TIMER_CNT_MS,
		    (now - ctx->sw_trig_time)/TIMER_CNT_MS);
    }

    /* preraw1 frm_done */
    if (isp_status.bits.FRAME_DONE_PRE1) {
	ctx->is_pre1_frame_done = 1;
        ctx->rc.preraw_done_cnt[1]++;

        if (!ctx->is_offline_preraw) {
            if (!ctx->is_stop)
                kick_pre1 = 1;
            else
                uartlog("csibdg closed, no kick frame_valid\n");
        }
    }

    /* postraw frm_done */
    if (isp_status.bits.FRAME_DONE_POST) {
	ctx->is_post_frame_done = 1;
        ctx->rc.postraw_proc_cnt++;

	if (is_dci_enable && (ctx->rc.postraw_proc_cnt % DCI_LUT_UPDATE_INTERVAL == 0)) {
	    uint16_t *dci_lut = (ictx->is_tile && ictx->is_work_on_r_tile)
			      ? dci_lut1 : dci_lut0;
	    _dci_lut_update(ictx);
	    ispblk_dci_config(ictx, true, dci_lut, ARRAY_SIZE(dci_lut));
	}

	if (!ctx->is_stop) {
	    if (ctx->is_offline_postraw) {
		if (ictx->is_tile && !ictx->is_work_on_r_tile) {
		    _right_tile(ictx);
		    isp_post_trig(ictx);
		    uartlog("### right tile\n");
		} else {
		    if (ctx->is_offline_scaler) {
			uartlog("### SCALER + ");
			if (is_sclr_job_done(ctx->sc_inst))
			    sclr_trig_start(ctx->sc_inst);
		    }
		}
	    } else {
		if (ctx->is_offline_scaler) {
		    uartlog("### SCALER + ");
		    sclr_trig_start(ctx->sc_inst);
		}
	    }

	    kick_pre0 = 1;
	} else
	    uartlog("csibdg closed, no kick frame_valid\n");
    }

    /* preraw frame start */
    if (isp_status.bits.FRAME_START_PRE) {
	ctx->is_pre0_frame_done = 0;
        ctx->rc.sof_cnt[0]++;
    }

    /* preraw frame start */
    if (isp_status.bits.FRAME_START_PRE1) {
	ctx->is_pre1_frame_done = 0;
        ctx->rc.sof_cnt[1]++;
    }

#if 0
    /* preraw frm_err */
    if (isp_status.bits.FRAME_ERR_PRE) {
    }
#endif

    if (kick_pre0) {
		if ((frame_count != 11111) && --frame_count <= 0) {
		    kick_pre0 = false;
		    ISP_WR_BITS(ctx->phys_regs[ISP_BLK_ID_CSIBDG0], REG_ISP_CSI_BDG_T, CSI_CTRL, CSI_ENABLE, 0);
		    uartlog("frame_count down to zero and stop...\n ");
		} else {
		    // only get next frame if post done
		    if (ctx->is_offline_postraw && is_raw_dump)
			raw_dump_next_buf(ctx->ptn->priv);
		    if (ctx->is_offline_scaler && is_yuv_dump)
			yuv_dump_next_buf(ctx->ptn->priv);
		    isp_pre_trig(ctx->ptn->priv);
		    uartlog("### isp kick %s!!!\n", "on eof");
		}
    }

    if (kick_pre1) {
    }

    last_end = timer_get_tick();

    uartlog("%s() [2_isr_time_gap(%ld) isp_enter(%ld) isr_exit(%ld)]:",
        __func__, (now - prev)/TIMER_CNT_MS, now/TIMER_CNT_MS, last_end/TIMER_CNT_MS);
    uartlog(" preraw_frame_vld(%d), top_st(0x%x) cbdg_st(0x%x) sof(%d) preraw(%d) postraw(%d)\n\n",
        frame_vld_pre0, isp_status.raw, csi_status.raw, ctx->rc.sof_cnt[0],
	ctx->rc.preraw_done_cnt[0], ctx->rc.postraw_proc_cnt);

    prev = now;

    return 0;
}

int prepare_dma_buffer()
{
    return 0;
}

int init_cmdq_mem(pattern_ctx *ctx)
{
    uint32_t nblocks, i, group;
    uint32_t vpipe_nodes[] = {ISPCQ_ID_PRERAW0, ISPCQ_ID_POSTRAW};
    struct isp_vblock_info *ispblks;

    ctx->vreg_bases = (uintptr_t *)PTN_MALLOC(ISP_BLK_ID_MAX * sizeof(uintptr_t), ctx);
    ctx->vreg_bases_pa = ctx->vreg_bases; // pa/va the same in bmtest
    memset(ctx->vreg_bases, 0, ISP_BLK_ID_MAX * sizeof(uintptr_t));

    for (group = 0; group < ARRAY_SIZE(vpipe_nodes); ++group) {
        uint32_t cq_id = vpipe_nodes[group];

        isp_get_vblock_info(&ispblks, &nblocks, cq_id);

        for (i = 0; i < nblocks; ++i) {
            ctx->vreg_bases[ispblks[i].block_id] = PTN_MALLOC(ispblks[i].block_size, ctx);
            uartlog("[0x%lx]alloc cmdq blk: %lx\n", ctx->phys_regs[ispblks[i].block_id], ctx->vreg_bases[ispblks[i].block_id]);

            if (!ctx->vreg_bases[ispblks[i].block_id]) {
                uartlog("%s error malloc vreg\n", __func__);
                return -1;
            }

            ispcq_init_cmdset((char *)(ctx->vreg_bases[ispblks[i].block_id]), ispblks[i].block_size, ispblks[i].reg_base);
        }

        ctx->adma_table[cq_id] = PTN_MALLOC(nblocks * ADMA_DESC_SIZE, ctx);
        ctx->adma_table_pa[cq_id] = ctx->adma_table[cq_id];
        if (!ctx->adma_table[cq_id]) {
            uartlog("%s error malloc vreg\n", __func__);
            return -1;
        }
        for (i = 0; i < nblocks; ++i) {
            ispcq_add_descriptor((char *)(ctx->adma_table[cq_id]), i, ctx->vreg_bases_pa[ispblks[i].block_id], ispblks[i].block_size);
        }
        ispcq_set_end_desc((char *)(ctx->adma_table[cq_id]), nblocks-1, 1);

        ispcq_set_end_cmdset((char *)(ctx->vreg_bases[ispblks[nblocks-1].block_id]), ispblks[nblocks-1].block_size);

    }

    #if 0
    uartlog("dump init cmdq vreg content .................\n");
    for (i = 0; i < ARRAY_SIZE(m_isp_blk_vreg_info); ++i) {
        unsigned char *ptr = (unsigned char *)ctx->vreg_bases[m_isp_blk_vreg_info[i].block_id];
        int j, range = (0x30 > m_isp_blk_vreg_info[i].block_size) ? m_isp_blk_vreg_info[i].block_size : 0x30;

        uartlog("\n BLOCK dump ------------ %lx\n", ctx->vreg_bases[m_isp_blk_vreg_info[i].block_id]);
        for (j = 0; j < range; j++) {
            if ((j & 0x7) == 0)
                uartlog("\n[0x%lx]: ", ctx->phys_regs[m_isp_blk_vreg_info[i].block_id]+j);
            uartlog("0x%02x ", *(ptr+j));
        }
        uartlog("\n");

        if (range >= 0x30) {
            for (j = m_isp_blk_vreg_info[i].block_size - 0x30; j < m_isp_blk_vreg_info[i].block_size; j++) {
                if ((j & 0x7) == 0)
                    uartlog("\n[0x%lx]: ", ctx->phys_regs[m_isp_blk_vreg_info[i].block_id]+j);
                uartlog("0x%02x ", *(ptr+j));
            }
            uartlog("\n");
        }
    }
    uartlog("dump end ------------------------------------\n");
    #endif

    return 0;
}

int uninit_cmdq_mem(pattern_ctx *ctx)
{
    return 0;
}


static int patgen_start(void *priv)
{
    pattern_ctx *ctx = (pattern_ctx *)priv;
    uint64_t isptopb, csib, preraw0;
    char line[16];
    (void)line;

    frame_count = 100;

    isptopb = ctx->phys_regs[ISP_BLK_ID_ISPTOP];
    csib = ctx->phys_regs[ISP_BLK_ID_CSIBDG0];
    preraw0 = ctx->phys_regs[ISP_BLK_ID_PRERAW0];

    ISP_WR_BITS(csib, REG_ISP_CSI_BDG_T, CSI_CTRL, RESET_MODE, 1);
    cli_readline("wait ready .................", line);

    ctx->is_stop = 0;

    #if 1
    uartlog("### org patgen total size: %dx%d\n",
        ISP_RD_BITS(csib, REG_ISP_CSI_BDG_T, CSI_TGEN_TT_SIZE, HTT),
        ISP_RD_BITS(csib, REG_ISP_CSI_BDG_T, CSI_TGEN_TT_SIZE, VTT));
    //ISP_WR_BITS(csib, REG_ISP_CSI_BDG_T, CSI_TGEN_TT_SIZE, VTT, 0x8CF);
    ISP_WR_BITS(csib, REG_ISP_CSI_BDG_T, CSI_TGEN_TT_SIZE, VTT, 0x6CF);
    //ISP_WR_BITS(csib, REG_ISP_CSI_BDG_T, CSI_TGEN_TT_SIZE, HTT, 0x293); // FPGA
    ISP_WR_BITS(csib, REG_ISP_CSI_BDG_T, CSI_TGEN_TT_SIZE, HTT, 0x693); // FPGA
    //ISP_WR_BITS(csib, REG_ISP_CSI_BDG_T, CSI_TGEN_TT_SIZE, HTT, 0xA9F); // PXP
    uartlog("### new patgen total size: %dx%d\n",
        ISP_RD_BITS(csib, REG_ISP_CSI_BDG_T, CSI_TGEN_TT_SIZE, HTT),
        ISP_RD_BITS(csib, REG_ISP_CSI_BDG_T, CSI_TGEN_TT_SIZE, VTT));
    #endif

    if (ISP_RD_BITS(preraw0, REG_PRE_RAW_T, FRAME_VLD, PRE_RAW_FRAME_VLD) == 0)
	ISP_WO_BITS(preraw0, REG_PRE_RAW_T, FRAME_VLD, PRE_RAW_FRAME_VLD, 1);
    else
        uartlog(" #### alread frame_valid state\n");
    uartlog(" #### frame_valid update state: 0x%x\n", ISP_RD_REG(isptopb, REG_ISP_TOP_T, REG_2));

    ISP_WO_BITS(csib, REG_ISP_CSI_BDG_T, CSI_BDG_UP, CSI_UP_REG, 1);

    ISP_WR_BITS(csib, REG_ISP_CSI_BDG_T, CSI_TGEN_ENABLE, INTERNAL_TIME_GEN_ENABLE, 1);

    ISP_WR_BITS(ctx->phys_regs[ISP_BLK_ID_CSIBDG0], REG_ISP_CSI_BDG_T, CSI_CTRL, CSI_ENABLE, 1);

    if (ctx->is_offline_postraw) {
        uint32_t addr;
        uint64_t dmasrc, dmadst;

        dmasrc = ctx->phys_regs[ISP_BLK_ID_DMA0];
        dmadst = ctx->phys_regs[ISP_BLK_ID_DMA6];
        uartlog("pre0 0x%lx to raw_top(le) 0x%lx\n", dmasrc, dmadst);
        addr = ISP_RD_REG(dmasrc, REG_ISP_DMA_T, DMA_0);
        ISP_WR_REG(dmadst, REG_ISP_DMA_T, DMA_0, addr);
        addr = ISP_RD_REG(dmasrc, REG_ISP_DMA_T, DMA_1);
        ISP_WR_REG(dmadst, REG_ISP_DMA_T, DMA_1, addr);


        dmasrc = ctx->phys_regs[ISP_BLK_ID_DMA1];
        dmadst = ctx->phys_regs[ISP_BLK_ID_DMA7];
        uartlog("pre1 0x%lx to raw_top(se) 0x%lx\n", dmasrc, dmadst);
        addr = ISP_RD_REG(dmasrc, REG_ISP_DMA_T, DMA_0);
        ISP_WR_REG(dmadst, REG_ISP_DMA_T, DMA_0, addr);
        addr = ISP_RD_REG(dmasrc, REG_ISP_DMA_T, DMA_1);
        ISP_WR_REG(dmadst, REG_ISP_DMA_T, DMA_1, addr);

        do {
            uartlog("runtime status: %d_%d\n", ctx->rc.preraw_done_cnt[0], ctx->rc.postraw_proc_cnt);
            if (ctx->rc.preraw_done_cnt[0] > ctx->rc.postraw_proc_cnt) {

                uartlog("trig postraw...\n");
		ctx->is_post_frame_done = 0;

		isp_post_trig(ctx->ptn->priv);
            }
            cli_readline("x to exit\n", line);
        } while (line[0] != 'x');
    }

    return 0;
}

static int patgen_stop(void *priv)
{
    pattern_ctx *ctx = (pattern_ctx *)priv;

    ctx->is_stop = 1;

	u16 count = 0;
	do {
		if (ctx->is_pre0_frame_done)
			break;
		mdelay(1);
	} while(++count < 100);
	if (count < 100) {
		uartlog("stop ok at %d\n", count);
	} else {
		uartlog("stop ng\n");
	}
    ISP_WR_BITS(ctx->phys_regs[ISP_BLK_ID_CSIBDG0], REG_ISP_CSI_BDG_T, CSI_CTRL, CSI_ENABLE, 0);
    ISP_WR_BITS(ctx->phys_regs[ISP_BLK_ID_CSIBDG0], REG_ISP_CSI_BDG_T, CSI_CTRL, CSI_MODE, 0);
    uartlog("frame sync disable\n");
    ISP_WR_BITS(ctx->phys_regs[ISP_BLK_ID_CSIBDG0], REG_ISP_CSI_BDG_T, CSI_TGEN_ENABLE, INTERNAL_TIME_GEN_ENABLE, 0);

    return 0;
}

int _handle_cfg_op(struct isp_ctx *ictx, u8 op, ...)
{
    int ret = 0;
    u32 tmp = 0;
    va_list ap;
    va_start(ap, op);

    switch(op) {
	case CFG_OP_EE_TUN_CFG:
	{
		struct cvi_vip_isp_ee_config cfg;
		memset((void *)&cfg, 0x0, sizeof(cfg));

		bm_get_num("enable(0/1):", cfg.enable);
		bm_get_num("dbg_mode(0~11):", cfg.dbg_mode);
		bm_get_num("total_coring(0~1023):", cfg.total_coring);
		bm_get_num("total_gain(0~255):", cfg.total_gain);

		if (cfg.enable > 1) {
			uartlog("ee enable should be 0/1\n");
			break;
		}

		if (cfg.dbg_mode > 11) {
			uartlog("ee dbg_mode should be 0~11\n");
			break;
		}

		if (cfg.total_coring > 1023) {
			uartlog("ee total_coring should be 0~1023\n");
			break;
		}

		if (cfg.total_gain > 255) {
			uartlog("ee total_gain should be 0~255\n");
			break;
		}

		cfg.luma_coring_lut    = luma_coring_lut;
		cfg.luma_adptctrl_lut  = luma_adptctrl_lut;
		cfg.delta_adptctrl_lut = delta_adptctrl_lut;
		cfg.luma_shtctrl_lut   = luma_shtctrl_lut;
		cfg.delta_shtctrl_lut  = delta_shtctrl_lut;

		cfg.ee_cfg.REG_04.bits.EE_TOTAL_OSHTTHRD = 255;
		cfg.ee_cfg.REG_04.bits.EE_TOTAL_USHTTHRD = 255;
		cfg.ee_cfg.REG_04.bits.EE_DEBUG_SHIFT_BIT = 0;
		cfg.ee_cfg.REG_08.bits.EE_STD_SHTCTRL_EN = 0;
		cfg.ee_cfg.REG_08.bits.EE_STD_SHTCTRL_MAX3X3_EN = 1;
		cfg.ee_cfg.REG_08.bits.EE_STD_SHTCTRL_MIN3X3_EN = 1;

		ispblk_ee_tun_cfg(ictx, &cfg);
	}
	break;

	case CFG_OP_GAMMA_TUN_CFG:
	{
		struct cvi_vip_isp_gamma_config cfg;
		u8 enable;

		memset((void *)&cfg, 0x0, sizeof(cfg));

		bm_get_num("enable(0/1):", enable);

		cfg.enable = enable;
		cfg.lut = gamma_data;

		uartlog("gamma data[256]=%u\n", cfg.lut[256]);

		ispblk_gamma_tun_cfg(ictx, &cfg);
	}
	break;

	case CFG_OP_GE_TUN_CFG:
	{
		struct cvi_vip_isp_ge_config cfg;
		u8 enable = 0, inst = 0;
		memset((void *)&cfg, 0x0, sizeof(cfg));

		bm_get_num("enable(0/1):", enable);
		bm_get_num("DPC_0/DPC_1(0/1):", inst);

		cfg.inst = inst;
		cfg.enable = enable;
		cfg.ge_cfg.DPC_10.bits.GE_STRENGTH = 0xa;
		cfg.ge_cfg.DPC_11.bits.GE_THRE1    = 0x100;
		cfg.ge_cfg.DPC_12.bits.GE_THRE3    = 0x200;
		cfg.ge_cfg.DPC_13.bits.GE_THRE11   = 0x300;
		cfg.ge_cfg.DPC_14.bits.GE_THRE31   = 0x400;

		ispblk_ge_tun_cfg(ictx, &cfg);
	}
	break;

	case CFG_OP_BLC:
	{
	    bool enable, bypass;
	    int blc_id = 0;
	    uartlog("BLC0(0), BLC1(1), BLC2(2), BLC3(3)\n");
	    bm_get_num("Which BLC to config(0~3): ", blc_id);
	    bm_get_num("enable(1)/disable(0): ", enable);
	    bm_get_num("bypass(1)/not bypass(0): ", bypass);
	    if (enable && !bypass) {
		uint16_t roffset, groffset, gboffset, boffset;
		bm_get_num("roffset(0~1023): ", roffset);
		bm_get_num("groffset(0~1023): ", groffset);
		bm_get_num("gboffset(0~1023): ", gboffset);
		bm_get_num("boffset(0~1023): ", boffset);
		ispblk_blc_set_offset(ictx, blc_id, roffset, groffset, gboffset, boffset);

		uint16_t rgain, grgain, gbgain, bgain;
		bm_get_num("rgain(0~32767): ", rgain);
		bm_get_num("grgain(0~32767): ", grgain);
		bm_get_num("gbgain(0~32767): ", gbgain);
		bm_get_num("bgain(0~32767): ", bgain);
		ispblk_blc_set_gain(ictx, blc_id, rgain, grgain, gbgain, bgain);
	    }
	    ispblk_blc_enable(ictx, blc_id, enable, bypass);
	}
	break;
	case CFG_OP_DPC:
	{
	    union REG_ISP_DPC_2 dpc_reg2;
	    enum ISP_RAW_PATH path;
	    dpc_reg2.raw = 0;
	    bm_get_num("LE(0)/SE(0): ", path);
	    bm_get_num("DPC enable(1)/disable(0): ", dpc_reg2.bits.DPC_ENABLE);
	    bm_get_num("GE enable(1)/disable(0): ", dpc_reg2.bits.GE_ENABLE);
	    if (dpc_reg2.bits.DPC_ENABLE) {
		bm_get_num("DPC dynamic BPC enable(1)/disable(0): ",
			    dpc_reg2.bits.DPC_DYNAMICBPC_ENABLE);
		bm_get_num("DPC static BPC enable(1)/disable(0): ",
			    dpc_reg2.bits.DPC_STATICBPC_ENABLE);
		bm_get_num("DPC cluster size(0~3): ",
			    dpc_reg2.bits.DPC_CLUSTER_SIZE);

		if (dpc_reg2.bits.DPC_STATICBPC_ENABLE) {
		    uint16_t x, y, offset = 0, count = 0;
		    uint32_t bps[40];

		    do {
			count = 0;
			do {
			    bm_get_num("defect pixel offset x: ", x);
			    bm_get_num("defect pixel offset y: ", y);
			    bps[count++] = (y << 12) | x;
			    bm_get_num("continue? y(1)/n(0): ", tmp);
			} while(tmp);

			ispblk_dpc_set_static(ictx, path, offset, bps, count);
			if (offset == 0) {
			    bm_get_num("continue for 4k right tile? (1)/n(0): ", tmp);
			    if (tmp == 0) break;
			    bm_get_num("offset for 4k right tile: ", offset);
			}
		    } while(tmp);
		}
	    }
	    ispblk_dpc_config(ictx, path, dpc_reg2);
	}
	break;
	case CFG_OP_WBG:
	{
	    bool enable, bypass;
	    int wbg_id = 0;
	    uartlog("WBG0(0), WBG1(1), WBG2(2), WBG3(3), WBG4(4) WBG0_R1(5), WBG1_R1(6)\n");
	    bm_get_num("Which WBG to config(0~6): ", wbg_id);
	    bm_get_num("enable(1)/disable(0): ", enable);
	    bm_get_num("bypass(1)/not bypass(0): ", bypass);
	    ispblk_wbg_enable(ictx, wbg_id, enable, bypass);
	    if (enable && !bypass) {
		uint16_t rgain, bgain, ggain;
		bm_get_num("rgain(0~16383): ", rgain);
		bm_get_num("ggain(0~16383): ", ggain);
		bm_get_num("bgain(0~16383): ", bgain);
		ispblk_wbg_config(ictx, wbg_id, rgain, ggain, bgain);
	    }
	}
	break;
	case CFG_OP_BNR:
	{
	    enum ISP_BNR_OUT out_sel;
	    bool lsc_en = false;
	    uint8_t ns_gain = 0, str = 0;
	    uartlog("Bypass(0), B_Delay(1), Factory(2), B_NL(3),    B_OUT(8),     INTENSITY(9)\n");
	    uartlog("DELTA(10), NOT_SM(11), FLAG_V(12), FLGA_H(13), FLAG_D45(14), FLAG_D135(15)\n");
	    bm_get_num("Which BNR output(0~15): ", out_sel);
	    if (out_sel != ISP_BNR_OUT_BYPASS) {
		bm_get_num("lsc enable(1)/disable(0): ", lsc_en);
		bm_get_num("ns_gain(0~255): ", ns_gain);
		bm_get_num("strength(0~255): ", str);
	    }
	    ispblk_bnr_config(ictx, out_sel, lsc_en, ns_gain, str);
	}
	break;
	case CFG_OP_FUSION:
	{
	    bool en = false, bypass = true, mc_en = false;
	    enum ISP_FS_OUT out_sel = ISP_FS_OUT_FS;
	    bm_get_num("fusion enable(1)/disable(0): ", en);
	    if (en) {
		bm_get_num("bypass(1)/not bypass(0): ", bypass);
		bm_get_num("mc enable(1)/disable(0): ", mc_en);
		uartlog("Fusion(0), Long exposure(1), Short exposure(2), short exposure expanded value(3)\n");
		bm_get_num("Which FS output(0~3): ", out_sel);
	    }
	    ispblk_fusion_config(ictx, en, bypass, mc_en, out_sel);
	}
	break;
	case CFG_OP_LTM:
	{
	    bool en = false, dehn_en = false, dlce_en = false;
	    bool behn_en = false, blce_en = false;
	    uint8_t hblk_size = 0, vblk_size = 0;
	    bm_get_num("ltm enable(1)/disable(0): ", en);
	    if (en) {
		bm_get_num("dark ehn enable(1)/disable(0): ", dehn_en);
		bm_get_num("dark lce enable(1)/disable(0): ", dlce_en);
		bm_get_num("bright ehn enable(1)/disable(0): ", behn_en);
		bm_get_num("bright lce enable(1)/disable(0): ", blce_en);
		bm_get_num("horizontal blk-size, 8(0)/16(1)/32(2)/64(4)/128(5): ", hblk_size);
		bm_get_num("vertical blk-size, 8(0)/16(1)/32(2)/64(4)/128(5): ", vblk_size);

		ispblk_ltm_config(ictx, dehn_en, dlce_en, behn_en, blce_en, hblk_size, vblk_size);
		ispblk_ltm_enable(ictx, true, false);
	    } else {
		ispblk_ltm_enable(ictx, true, true);
	    }
	}
	break;
	case CFG_OP_RGB_PROB:
	{
	    uint16_t x, y, r, g, b;
	    enum ISP_RGB_PROB_OUT out;
	    uartlog("Prob out: cfa(0), rgbee(1), ccm(2), gma(3), dhz(4), hsv(5), rgbdither(6), csc(7)");
	    bm_get_num(": ", out);
	    bm_get_num("x: ", x);
	    bm_get_num("y: ", y);
	    ispblk_rgb_prob_set_pos(ictx, out, x, y);
	    ispblk_rgb_prob_get_values(ictx, &r, &g, &b);
	    uartlog("(%d, %d) RGB: %d-%d-%d\n", x, y, r, g, b);
	}
	break;
	case CFG_OP_GAMMA:
	{
	    bool en = false;
	    uint8_t sel = 0;
	    bm_get_num("enable(1/0): ", en);
	    if (en) {
		bm_get_num("which gamma data want to use? (0, 1): ", sel);
	    }
	    ispblk_gamma_enable(ictx, en, sel);
	}
	break;
	case CFG_OP_DHZ:
	{
	    bool en = false;
	    bm_get_num("enable(1/0): ", en);
	    if (en) {
		bm_get_num("strength(0~127): ", dhz_cfg.strength);
		bm_get_num("smooth threshold(0~1023): ", dhz_cfg.th_smooth);
	    }
	    ispblk_dhz_config(ictx, en, &dhz_cfg);
	}
	break;
	case CFG_OP_HSV:
	{
	    bool en = false;
	    bool hsgain_en, hvgain_en, htune_en, stune_en;
	    uint8_t sel = 0;
	    bm_get_num("enable(1/0): ", en);
	    if (en) {
		bm_get_num("which hsv data want to use? (0, 1): ", sel);
		bm_get_num("sgain enable(1/0): ", hsgain_en);
		bm_get_num("vgain enable(1/0): ", hvgain_en);
		bm_get_num("htune enable(1/0): ", htune_en);
		bm_get_num("stune enable(1/0): ", stune_en);
	    }
	    ispblk_hsv_enable(ictx, en, sel, hsgain_en, hvgain_en, htune_en, stune_en);
	}
	break;
	case CFG_OP_RGB_DITHER:
	{
	    bool en, mod_en, histidx_en, fmnum_en;
	    en = mod_en = histidx_en = fmnum_en = false;
	    bm_get_num("enable(1/0): ", en);
	    if (en) {
		bm_get_num("mod enable(1/0): ", mod_en);
		bm_get_num("histidx enable(1/0): ", histidx_en);
		bm_get_num("fmnum enable(1/0): ", fmnum_en);
	    }
	    ispblk_rgbdither_config(ictx, en, mod_en, histidx_en, fmnum_en);
	}
	break;
	case CFG_OP_RGB_EE:
	{
	    bool en = false;
	    uint16_t osgain = 358, usgain = 310;
	    bm_get_num("enable(1/0): ", en);
	    if (en) {
		bm_get_num("osgain(0~1023): ", osgain);
		bm_get_num("usgain(0~1023): ", usgain);
	    }
	    ispblk_rgbee_config(ictx, en, osgain, usgain);
	}
	break;
	case CFG_OP_444_422:
	{
	}
	break;
	case CFG_OP_YUV_DITHER:
	{
	    uint8_t sel = 0;
	    bool en, mod_en, histidx_en, fmnum_en;
	    en = mod_en = histidx_en = fmnum_en = false;

	    bm_get_num("which dither? y(1)/uv(0): ", sel);
	    bm_get_num("enable(1/0): ", en);
	    if (en) {
		bm_get_num("mod enable(1/0): ", mod_en);
		bm_get_num("histidx enable(1/0): ", histidx_en);
		bm_get_num("fmnum enable(1/0): ", fmnum_en);
	    }
	    ispblk_yuvdither_config(ictx, sel, en, mod_en, histidx_en, fmnum_en);
	}
	break;
	case CFG_OP_YNR:
	{
	    enum ISP_YNR_OUT out_sel;
	    uint8_t ns_gain = 0, str = 0;
	    uartlog("Bypass(0),    Y_Delay(1), Factory(2), ALPHA(3)  , Y_BF(4),    Y_NL(5),      Y_OUT(8)\n")
	    uartlog("INTENSITY(9), DELTA(10),  NOT_SM(11), FLAG_V(12), FLGA_H(13), FLAG_D45(14), FLAG_D135(15)\n");
	    bm_get_num("Which YNR output(0~15): ", out_sel);
	    if (out_sel != ISP_YNR_OUT_BYPASS) {
		bm_get_num("ns_gain(0~255): ", ns_gain);
		bm_get_num("strength(0~255): ", str);
	    }
	    ispblk_ynr_config(ictx, out_sel, ns_gain, str);
	}
	break;
	case CFG_OP_CNR:
	{
	    bool en = false, pfc_en;
	    uint8_t str = 0;
	    bm_get_num("enable(1/0): ", en);
	    if (en) {
		bm_get_num("pfc enable(1/0): ", pfc_en);
		bm_get_num("strength(0~255): ", str);
	    }
	    ispblk_cnr_config(ictx, en, pfc_en, str);
	}
	break;
	case CFG_OP_YCUR:
	{
	    bool en = false;
	    uint8_t sel = 0;
	    bm_get_num("enable(1/0): ", en);
	    if (en) {
		bm_get_num("which ycurve data want to use? (0, 1): ", sel);
	    }
	    ispblk_ycur_enable(ictx, en, sel);
	}
	case CFG_OP_DCI:
	{
	    bool en = false;
	    bm_get_num("enable(1/0): ", en);
	    if (en)
		_dci_lut_update(ictx);
	    ispblk_dci_config(ictx, en, dci_lut0, ARRAY_SIZE(dci_lut0));
	    is_dci_enable = en;
	}
	break;
	case CFG_OP_DMA_RING_BUFFER:
	{
		bool en = false;
		bm_get_num("enable(1/0): ", en);

		ispblk_dma_ring_buffer_test(ictx, ISP_BLK_ID_DMA6, en);
	}
	break;
    }

    va_end(ap);

    return ret;
}

static int patgen_isppath_start(void *priv)
{
#ifdef VIP_PERFORMANCE_TEST
    vip_stress_start();
#else
    pattern_ctx *ctx = (pattern_ctx *)priv;
    struct isp_ctx *ictx = ctx->ptn->priv;
    int tmp;

    bm_get_num("how many frames to go??[11111 then never end]: ", frame_count);

    ctx->is_stop = 0;

    isp_streaming(ictx, 1);
    isp_pre_trig(ictx);

    char line[16];
    do {
	uartlog("\n--------------------------------------------------------------------\n");
	uartlog("runtime status: frame_done count pre(%d) post(%d)\n",
		ctx->rc.preraw_done_cnt[0], ctx->rc.postraw_proc_cnt);
	uartlog("1) set gain\t2) set sgain\t3) set shs le\t4) set shs se\n");
	cli_readline("c) to config isp\tg) to go\td) to dump\tx) to exit\n", line);
	if ((line[0] == 'g') || (line[0] == 'd')) {
	    bm_get_num("how many frames to go??[11111 then never end]: ", frame_count);
	    if (line[0] == 'd') {
		bm_get_num("dump raw(0) or yuv(1): ", tmp);
		if (tmp == 0) {
		    is_raw_dump = true;
		    raw_dump_next_buf(ictx);
		} else {
		    is_yuv_dump = true;
		    yuv_dump_next_buf(ictx);
		}
	    }

	    isp_streaming(ictx, 1);
	    isp_pre_trig(ictx);
	} else if (line[0] == '1') {
	    struct sensor_prop prop;
	    uint16_t gain = 0;
	    uartlog("dbg0\n");
	    sensor_get_gain(get_sensor_ctx()->ptn, &prop);
	    uartlog("gain cur(%d) min(%d) max(%d)\n", prop.cur, prop.min, prop.max);

	    bm_get_num("new gain value: ", gain);
	    sensor_set_gain(get_sensor_ctx()->ptn, gain);
	} else if (line[0] == '2') {
	    struct sensor_prop prop;
	    uint16_t sgain = 0;
	    uartlog("dbg0\n");
	    sensor_get_sgain(get_sensor_ctx()->ptn, &prop);
	    uartlog("sgain cur(%d) min(%d) max(%d)\n", prop.cur, prop.min, prop.max);

	    bm_get_num("new sgain value: ", sgain);
	    sensor_set_sgain(get_sensor_ctx()->ptn, sgain);
	} else if (line[0] == '3') {
	    struct sensor_prop prop;
	    uint32_t shs = 0;
	    sensor_get_shsl(get_sensor_ctx()->ptn, &prop);
	    uartlog("shsl cur(%d) min(%d) max(%d)\n", prop.cur, prop.min, prop.max);

	    bm_get_num("new shs(le) value: ", shs);
	    sensor_set_shsl(get_sensor_ctx()->ptn, shs);
	} else if (line[0] == '4') {
	    struct sensor_prop prop;
	    uint32_t shs = 0;
	    sensor_get_shss(get_sensor_ctx()->ptn, &prop);
	    uartlog("shsl cur(%d) min(%d) max(%d)\n", prop.cur, prop.min, prop.max);

	    bm_get_num("new shs(se) value: ", shs);
	    sensor_set_shss(get_sensor_ctx()->ptn, shs);
	} else if (line[0] == 'c') {
	    u8 op = 0xff;
	    uartlog("\n--------------------------------------------------------------------\n");
	    uartlog("00) wbg      01) blc        02) dpc        03) fusion     04) ltm\n");
	    uartlog("05) bnr\n");
	    uartlog("10) rgb_prob 11) rgb_ee     12) gamma      13) dehaze     14) hsv\n");
	    uartlog("15) rgb dither\n");
	    uartlog("20) 444_422  21) yuv dither 22) ynr        23) cnr        24) ycur\n");
	    uartlog("25) dci      26) ge_tun     27) gamma_tun  28) ee_tun     29) dma ring buffer\n");
	    uartlog("255) exit\n");
	    bm_get_num(": ", op);

	    _handle_cfg_op(ictx, op);
	}
    } while (line[0] != 'x');
#endif
    return 0;
}

static int patgen_isppath_stop(void *priv)
{
    pattern_ctx *ctx = (pattern_ctx *)priv;
    struct isp_ctx *ictx = ctx->ptn->priv;
    u16 count = 0;

    ctx->is_stop = 1;
    do {
	if (ctx->is_pre0_frame_done)
	    break;
	mdelay(10);
    } while(++count < 100);
    if (count < 100) {
	uartlog("stop ok at %d\n", count);
    } else {
	uartlog("stop ng\n");
    }
    isp_streaming(ictx, 0);

    return 0;
}

static int memin_start(void *priv)
{
    pattern_ctx *ctx = (pattern_ctx *)priv;
    uint64_t isptopb;
    char line[16];

    isptopb = ctx->phys_regs[ISP_BLK_ID_ISPTOP];

    ISP_WO_BITS(isptopb, REG_ISP_TOP_T, REG_2, SHAW_UP_PRE, 1);
    ISP_WO_BITS(isptopb, REG_ISP_TOP_T, REG_2, SHAW_UP_POST, 1);

    cli_readline("before trig job start\n", line);
    ISP_WO_BITS(isptopb, REG_ISP_TOP_T, REG_2, TRIG_STR_POST, 1);
    ctx->sw_trig_time = timer_get_tick();
    ISP_WO_BITS(isptopb, REG_ISP_TOP_T, REG_2, TRIG_STR_PRE, 1);

    return 0;
}

static int memin_stop(void *priv)
{
    //pattern_ctx *ctx = (pattern_ctx *)priv;

    return 0;
}

void tile_cal_size(struct isp_ctx *ictx)
{
    const int guard = 0x40;
    int left_width = ((ictx->img_width >> 1) + 0x7F) & ~0x7F;

    ictx->tile_cfg.l_in.start  = 0;
    ictx->tile_cfg.l_in.end    = left_width - 1 + (guard << 1);
    ictx->tile_cfg.l_out.start = 0;
    ictx->tile_cfg.l_out.end   = left_width - 1 + guard;
    ictx->tile_cfg.r_in.start  = left_width;
    ictx->tile_cfg.r_in.end    = ictx->img_width - 1;
    ictx->tile_cfg.r_out.start = left_width + guard;
    ictx->tile_cfg.r_out.end   = ictx->img_width - 1;
    uartlog("tile cfg: Left in(%d %d) out(%d %d)\n",
	    ictx->tile_cfg.l_in.start, ictx->tile_cfg.l_in.end,
	    ictx->tile_cfg.l_out.start, ictx->tile_cfg.l_out.end);
    uartlog("tile cfg: Right in(%d %d) out(%d %d)\n",
	    ictx->tile_cfg.r_in.start, ictx->tile_cfg.r_in.end,
	    ictx->tile_cfg.r_out.start, ictx->tile_cfg.r_out.end);
}

static int pattern_isp_flow_patgen2dram(void *priv)
{
    pattern_ctx *ctx = (pattern_ctx *)priv;
    uint64_t isptop, csi_bdg;
    uint64_t *phys_regs;

    uartlog("%s ... %d reg=%p\n", __func__, ISP_BLK_ID_ISPTOP, ctx->phys_regs);

    isptop = ctx->phys_regs[ISP_BLK_ID_ISPTOP];
    csi_bdg = ctx->phys_regs[ISP_BLK_ID_CSIBDG0];

    phys_regs = ctx->phys_regs;

    ISP_WR_REG(csi_bdg, REG_ISP_CSI_BDG_T, CSI_INTERRUPT_STATUS, 0x3F);
    ISP_WR_REG(isptop, REG_ISP_TOP_T, REG_0, 0x1FF);

    uartlog("starting load pattern...\n");
    uartlog("allocate memory space for postraw:\n");
    #include "patterns/isp_flow_patgen2dram/register.cfg.h"
    uartlog("end load pattern...\n");

    // larger vtt to avoid pre/post raw intr hit together
    uint32_t _tmp;
    _tmp = (PTN_REG_READ(phys_regs[0x1]+0x44)&0xe000ffff)|0x4000000;
    PTN_REG_WRITE(phys_regs[0x1]+0x44, _tmp); // isp_csi_bdg0.reg_vtt

    prepare_dma_buffer();

    return 0;
}

static int pattern_isp_flow_patgen2dram_cmdq(void *priv)
{
    pattern_ctx *ctx = (pattern_ctx *)priv;
    uint64_t isptop, csi_bdg;
    uint64_t *reg_bases, *phys_regs;
    struct ispcq_config preraw_cqcfg, postraw_cqcfg;
    char line[8];

    isptop = ctx->phys_regs[ISP_BLK_ID_ISPTOP];
    csi_bdg = ctx->phys_regs[ISP_BLK_ID_CSIBDG0];

    init_cmdq_mem(ctx);

    reg_bases = ctx->vreg_bases;
    phys_regs = ctx->phys_regs;

    ISP_WR_REG(csi_bdg, REG_ISP_CSI_BDG_T, CSI_INTERRUPT_STATUS, 0x3F);
    ISP_WR_REG(isptop, REG_ISP_TOP_T, REG_0, 0x1FF);

    cli_readline("starting cq preload...\n", line);
    #include "patterns/isp_flow_patgen2dram/register.cfg_cqload.h"

    uartlog("starting load pattern...\n");
    #include "patterns/isp_flow_patgen2dram/register.cfg_virt.h"
    uartlog("end load pattern...\n");

    prepare_dma_buffer();

    cli_readline("config cmdq engine...\n", line);
    preraw_cqcfg.op_mode = ISPCQ_OP_ADMA;
    preraw_cqcfg.intr_en = 2;
    preraw_cqcfg.cq_id = ISPCQ_ID_PRERAW0;
    preraw_cqcfg.adma_table_pa = ctx->adma_table[ISPCQ_ID_PRERAW0];
    preraw_cqcfg.cmdset_size = 0;
    ispcq_engine_config(phys_regs, &preraw_cqcfg);

    postraw_cqcfg.op_mode = ISPCQ_OP_ADMA;
    postraw_cqcfg.intr_en = 2;
    postraw_cqcfg.cq_id = ISPCQ_ID_POSTRAW;
    postraw_cqcfg.adma_table_pa = ctx->adma_table[ISPCQ_ID_POSTRAW];
    postraw_cqcfg.cmdset_size = 0;
    ispcq_engine_config(phys_regs, &postraw_cqcfg);

    cli_readline("cmdq engine start...\n", line);
    ispcq_engine_start(phys_regs, ISPCQ_ID_POSTRAW);
    cli_readline("cmdq engine start 2\n", line);
    ispcq_engine_start(phys_regs, ISPCQ_ID_PRERAW0);
    cli_readline("cmdq engine start 3\n", line);

    //activate each cmdset by regs specified in pattern
    //cq r/w reg offset need x2
    //register cmdq irq handler => should be the same with isp
    //set ba to dma & trig init setting

    return 0;
}

static void _get_manual_params(pattern_ctx *ctx)
{
    struct isp_ctx *ictx = ctx->ptn->priv;

#if defined(VIP_PERFORMANCE_TEST)
    crop0.x = 0;
    crop0.y = 0;
    crop0.w = ictx->src_width;
    crop0.h = ictx->src_height;
    ictx->rgb_color_mode = 1;
    ictx->csibdg_patgen_en = 1;
    ictx->is_yuv_sensor = 0;
    ictx->is_hdr_on = 1;
    ictx->is_3dnr_on = 1;
    ictx->is_dpcm_on = 0;
    ictx->is_offline_preraw = 0;
    ictx->is_offline_postraw = 1;
    ictx->is_offline_scaler = 1;
    ctx->sc_inst = SCL_IMG_D;
    ictx->img_width = crop0.w;
    ictx->img_height = crop0.h;
    ictx->sensor_bitdepth = 12;
#elif defined(ISP_DUMP_TOOL)
    // specific for imx290
    ictx->src_width = 1308;
    ictx->src_height = 736;
    crop0.x = 12;
    crop0.y = 11;
    crop0.w = 1280;
    crop0.h = 720;
    ictx->rgb_color_mode = 1;
    ictx->csibdg_patgen_en = 0;
    ictx->is_yuv_sensor = 0;
    ictx->is_hdr_on = 1;
    ictx->is_3dnr_on = 0;
    ictx->is_tile = 0;
    ictx->is_offline_postraw = 1;
    ictx->is_offline_scaler = 0;
    ctx->sc_inst = 0;
    ictx->img_width = crop0.w;
    ictx->img_height = crop0.h;
    ictx->sensor_bitdepth = 12;
#else
    int		tmp = 0;
    //ictx.inparm;
    bm_get_num("preraw src? sensor(0)/patgen(1)/mem(2): ", tmp);
    if (tmp == 0) {
	ictx->csibdg_patgen_en = 0;
	ictx->is_offline_preraw = 0;

	uartlog("imx290(0), ar0239(1), imx327(2), manual(others)\n");
	bm_get_num("which sensor used?: ", tmp);

	if (tmp == 0) {
	    ictx->src_width = 1308;
	    ictx->src_height = 736;
	    crop0.x = 12;
	    crop0.y = 11;
	    crop0.w = 1280;
	    crop0.h = 720;
	    ictx->is_yuv_sensor = 0;
	    ictx->rgb_color_mode = ISP_BAYER_TYPE_GB;
	} else if (tmp == 1) {
	    ictx->src_width = 1280;
	    ictx->src_height = 720;
	    crop0.x = 0;
	    crop0.y = 0;
	    crop0.w = 1280;
	    crop0.h = 720;
	    ictx->is_yuv_sensor = 0;
	    ictx->rgb_color_mode = ISP_BAYER_TYPE_GB;
	} else if (tmp == 2) {
	    bm_get_num("snsr hdr? y(1)/n(0): ", tmp);
	    if (tmp == 0) {
		ictx->src_width = 1948;
		ictx->src_height = 1097;
		crop0.x = 12;
		crop0.y = 8;
	    } else {
		ictx->src_width = 1952;
		ictx->src_height = 1114;
		crop0.x = 16;
		crop0.y = 18;
		crop1.x = 16;
		crop1.y = 23;
		crop1.w = 1920;
		crop1.h = 1080;
	    }
	    crop0.w = 1920;
	    crop0.h = 1080;
	    ictx->is_yuv_sensor = 0;
	    ictx->rgb_color_mode = ISP_BAYER_TYPE_RG;
	} else {
	    bm_get_num("width: ", ictx->src_width);
	    bm_get_num("height: ", ictx->src_height);
	    bm_get_num("input format: yuv(1)/bayer(0): ", ictx->is_yuv_sensor);
	    if (!ictx->is_yuv_sensor) {
		bm_get_num("input bayer format? BG(0)/GR(1)/GB(2)/RG(3): ", ictx->rgb_color_mode);
		ictx->sensor_bitdepth = 12;
	    } else {
		bm_get_num("bitdepth 8/10: ", ictx->sensor_bitdepth);
	    }

	    crop0.x = 0;
	    crop0.y = 0;
	    crop0.w = ictx->src_width;
	    crop0.h = ictx->src_height;
	    crop1.x = 0;
	    crop1.y = 0;
	    crop1.w = ictx->src_width;
	    crop1.h = ictx->src_height;
	}
    } else {
	ictx->csibdg_patgen_en = (tmp == 1);
	ictx->is_offline_preraw = (tmp == 2);

	bm_get_num("width: ", ictx->src_width);
	bm_get_num("height: ", ictx->src_height);
	bm_get_num("input format: yuv(1)/bayer(0): ", ictx->is_yuv_sensor);
	if (!ictx->is_yuv_sensor)
	    bm_get_num("input bayer format? BG(0)/GR(1)/GB(2)/RG(3): ", ictx->rgb_color_mode);

	crop0.x = 0;
	crop0.y = 0;
	crop1.x = 0;
	crop1.y = 0;
	crop0.w = ictx->src_width;
	crop0.h = ictx->src_height;
	crop1.w = ictx->src_width;
	crop1.h = ictx->src_height;

	ictx->sensor_bitdepth = 12;
    }
    ictx->img_width = crop0.w;
    ictx->img_height = crop0.h;

    // ** if crop odd line, bayer format changes
    ictx->rgb_color_mode = isp_bayer_remap(ictx->rgb_color_mode, crop0.x, crop0.y);

    bm_get_num("3dnr? y(1)/n(0): ", ictx->is_3dnr_on);
    if (ictx->is_yuv_sensor == 0) {
	bm_get_num("hdr? y(1)/n(0): ", ictx->is_hdr_on);
    } else {
	ictx->is_hdr_on = 0;
    }
    bm_get_num("dpcm? y(1)/n(0): ", ictx->is_dpcm_on);
    bm_get_num("tile used?: ", ictx->is_tile);
    if (ictx->is_hdr_on || ictx->is_tile) {
	ictx->is_offline_postraw = 1;
    } else {
	bm_get_num("preraw write to dram? y(1)/n(0): ", ictx->is_offline_postraw);
    }
    bm_get_num("postraw to mem(1)/sc(0): ", ictx->is_offline_scaler);
    //if (!ictx->is_offline_scaler)
	bm_get_num("which sc inst? v(0)/d(1): ", ctx->sc_inst);

    if (ictx->is_tile) {
		tile_cal_size(ictx);
		ictx->is_work_on_r_tile = 0;
	}
#endif

    ctx->is_offline_postraw = ictx->is_offline_postraw;
    ctx->is_offline_preraw = ictx->is_offline_preraw;
    ctx->is_offline_scaler = ictx->is_offline_scaler;

    ictx->phys_regs = ctx->phys_regs;

    ictx->cam_id = 0;

    ictx->vreg_page_idx = 0;
}

static int pattern_isp_flow_manual(void *priv)
{
    pattern_ctx *ctx = (pattern_ctx *)priv;
    struct isp_ctx *ictx = ctx->ptn->priv;
    uint32_t    bufsize;
    uint64_t    bufaddr;

    _get_manual_params(ctx);

    raw_dump_reset();
    yuv_dump_reset();

    isp_reset(ictx);
    isp_init(ictx);
    //isp_pchk_config(ictx, 0xf1);

    // preraw
    ispblk_preraw_config(ictx);
    ispblk_csibdg_config(ictx);

    ispblk_crop_config(ictx, ISP_BLK_ID_CROP0, crop0);
    ispblk_crop_config(ictx, ISP_BLK_ID_CROP2, crop0);
    if (ictx->is_hdr_on) {
	ispblk_crop_config(ictx, ISP_BLK_ID_CROP1, crop1);
	ispblk_crop_config(ictx, ISP_BLK_ID_CROP3, crop1);
    }

    ispblk_rgbmap_config(ictx, ISP_BLK_ID_RGBMAP0);
    bufaddr = rgbmap_addr[0];
    bufsize = ispblk_dma_config(ictx, ISP_BLK_ID_DMA15, bufaddr);
    uartlog("rgbmap 0:0x%lx 0x%x\n", bufaddr, bufsize);

    ispblk_lscr_set_lut(ictx, ISP_BLK_ID_LSCR0, lscr_lut, ARRAY_SIZE(lscr_lut));
    ispblk_lscr_config(ictx, ISP_BLK_ID_LSCR0, false);

    if (ictx->is_hdr_on) {
	ispblk_rgbmap_config(ictx, ISP_BLK_ID_RGBMAP1);
	bufaddr = rgbmap_addr[1];
	bufsize = ispblk_dma_config(ictx, ISP_BLK_ID_DMA16, bufaddr);
	uartlog("rgbmap 1:0x%lx 0x%x\n", bufaddr, bufsize);

	ispblk_lmap_config(ictx, ISP_BLK_ID_LMP0, true);
	bufaddr = lmap_addr[0];
	bufsize = ispblk_dma_config(ictx, ISP_BLK_ID_DMA9, bufaddr);
	ispblk_dma_config(ictx, ISP_BLK_ID_DMA12, bufaddr);
	uartlog("lmap 0:0x%lx 0x%x\n", bufaddr, bufsize);

	ispblk_lmap_config(ictx, ISP_BLK_ID_LMP1, true);
	bufaddr = lmap_addr[1];
	bufsize = ispblk_dma_config(ictx, ISP_BLK_ID_DMA14, bufaddr);
	ispblk_dma_config(ictx, ISP_BLK_ID_DMA13, bufaddr);
	uartlog("lmap 1:0x%lx 0x%x\n", bufaddr, bufsize);

	ispblk_lscr_set_lut(ictx, ISP_BLK_ID_LSCR1, lscr_lut, ARRAY_SIZE(lscr_lut));
	ispblk_lscr_config(ictx, ISP_BLK_ID_LSCR1, false);
    } else {
	ispblk_lmap_config(ictx, ISP_BLK_ID_LMP0, false);
	ispblk_lmap_config(ictx, ISP_BLK_ID_LMP1, false);
    }

    // sts
    bufaddr = sts_addr[0];
    ispblk_awb_config(ictx, ISP_BLK_ID_AWB0, true);
    bufsize = ispblk_dma_config(ictx, ISP_BLK_ID_DMA39, bufaddr);
    uartlog("awb0 :0x%lx 0x%x\n", bufaddr, bufsize);
    bufaddr += bufsize;

    ispblk_awb_config(ictx, ISP_BLK_ID_AWB4, true);
    bufsize = ispblk_dma_config(ictx, ISP_BLK_ID_DMA45, bufaddr);
    uartlog("awb4 :0x%lx 0x%x\n", bufaddr, bufsize);
    bufaddr += bufsize;

    ispblk_aehist_config(ictx, ISP_BLK_ID_AEHIST0, true);
    bufsize = ispblk_dma_config(ictx, ISP_BLK_ID_DMA33, bufaddr);
    uartlog("ae0(le) :0x%lx 0x%x\n", bufaddr, bufsize);
    bufaddr += bufsize;
    bufsize = ispblk_dma_config(ictx, ISP_BLK_ID_DMA34, bufaddr);
    uartlog("ae1(le) :0x%lx 0x%x\n", bufaddr, bufsize);
    bufaddr += bufsize;
    bufsize = ispblk_dma_config(ictx, ISP_BLK_ID_DMA35, bufaddr);
    uartlog("hist(le) :0x%lx 0x%x\n", bufaddr, bufsize);
    bufaddr += bufsize;

    ispblk_af_config(ictx, ISP_BLK_ID_AF, true);
    ispblk_af_gamma_config(ictx, ISP_BLK_ID_AF_GAMMA, 0, af_gamma_data);
    ispblk_af_gamma_enable(ictx, ISP_BLK_ID_AF_GAMMA, true, 0);
    bufsize = ispblk_dma_config(ictx, ISP_BLK_ID_DMA17, bufaddr);
    uartlog("af :0x%lx 0x%x\n", bufaddr, bufsize);
    bufaddr += bufsize;

    ispblk_gms_config(ictx, ISP_BLK_ID_GMS, true);
    bufsize = ispblk_dma_config(ictx, ISP_BLK_ID_DMA41, bufaddr);
    uartlog("gms :0x%lx 0x%x\n", bufaddr, bufsize);
    bufaddr += bufsize;

    if (ictx->is_hdr_on) {
	ispblk_awb_config(ictx, ISP_BLK_ID_AWB1, true);
	bufsize = ispblk_dma_config(ictx, ISP_BLK_ID_DMA40, bufaddr);
	uartlog("awb1 :0x%lx 0x%x\n", bufaddr, bufsize);
	bufaddr += bufsize;
	ispblk_aehist_config(ictx, ISP_BLK_ID_AEHIST1, true);
	bufsize = ispblk_dma_config(ictx, ISP_BLK_ID_DMA37, bufaddr);
	uartlog("ae0(se) :0x%lx 0x%x\n", bufaddr, bufsize);
	bufaddr += bufsize;
	bufsize = ispblk_dma_config(ictx, ISP_BLK_ID_DMA38, bufaddr);
	uartlog("hist(se) :0x%lx 0x%x\n", bufaddr, bufsize);
	bufaddr += bufsize;
    }

#if 0	// for bypass most modules
    union REG_ISP_DPC_2 dpc_reg2;
    dpc_reg2.raw = 0;
    ispblk_dpc_config(ictx, ISP_RAW_PATH_LE, dpc_reg2);
    ispblk_rawtop_config(ictx);
    ispblk_fusion_config(ictx, false, true, false, ISP_FS_OUT_FS);
    ispblk_bnr_config(ictx, ISP_BNR_OUT_BYPASS, false, 0, 0);

    ispblk_rgb_config(ictx);
    ispblk_cfa_config(ictx);
    ispblk_rgbee_config(ictx, false, 358, 310);
    ispblk_dhz_config(ictx, false, 30, 200);
    ispblk_rgbdither_config(ictx, false, true, true, true);
    ispblk_csc_config(ictx);

    ispblk_yuvtop_config(ictx);
    ispblk_yuvdither_config(ictx, 0, false, true, true, true);
    ispblk_yuvdither_config(ictx, 1, false, true, true, true);
    ispblk_444_422_config(ictx);
    ispblk_ynr_config(ictx, ISP_YNR_OUT_BYPASS, 16, 0);
    ispblk_cnr_config(ictx, false, true, 32);
    ispblk_ee_config(ictx, false, false);
    ispblk_ycur_config(ictx, 0, ycur_data);
#else
    isp_rawtop_update(ictx);
    isp_rgbtop_update(ictx);
    isp_yuvtop_update(ictx);

    ispblk_crop_enable(ictx, ISP_BLK_ID_CROP4, false);
    ispblk_crop_enable(ictx, ISP_BLK_ID_CROP5, false);
    ispblk_crop_enable(ictx, ISP_BLK_ID_CROP6, false);
#endif

    ispblk_isptop_config(ictx);

    // dma ctrl
    if (ictx->is_offline_preraw) {
	bufaddr = bayer_r_addr[0];
	bufsize = ispblk_dma_config(ictx, ISP_BLK_ID_DMA8, bufaddr);
	uartlog("bayer addr for dma8(pre0): 0x%lx, size: 0x%x\n", bufaddr, bufsize);

	ispblk_dma_enable(ictx, ISP_BLK_ID_DMA8, 1);
    } else {
	ispblk_dma_enable(ictx, ISP_BLK_ID_DMA8, 0);
    }

    uartlog("**************************************************************\n");

    return 0;
}

static int pattern_isp_flow_dram2dram(void *priv)
{
    pattern_ctx *ctx = (pattern_ctx *)priv;
    uint64_t isptop;
    uint64_t *phys_regs;

    ctx->is_offline_preraw = 1;

    isptop = ctx->phys_regs[ISP_BLK_ID_ISPTOP];

    phys_regs = ctx->phys_regs;

    ISP_WR_REG(isptop, REG_ISP_TOP_T, REG_0, 0x1FF);

    uartlog("starting load pattern...\n");
    #include "patterns/isp_flow_dram2dram/register.cfg.h"
    uartlog("end load pattern...\n");

    prepare_dma_buffer();

    return 0;
}

static int pattern_isp_dma_patgen2dram(void *priv)
{
    pattern_ctx *ctx = (pattern_ctx *)priv;
    uint64_t isptop, csi_bdg;
    uint64_t *phys_regs;

    ctx->is_offline_postraw = 1;

    isptop = ctx->phys_regs[ISP_BLK_ID_ISPTOP];
    csi_bdg = ctx->phys_regs[ISP_BLK_ID_CSIBDG0];

    phys_regs = ctx->phys_regs;

    ISP_WR_REG(csi_bdg, REG_ISP_CSI_BDG_T, CSI_INTERRUPT_STATUS, 0x3F);
    ISP_WR_REG(isptop, REG_ISP_TOP_T, REG_0, 0x1FF);

    uartlog("starting load pattern...\n");
    #include "patterns/isp_dma_patgen2dram/register.cfg.h"
    uartlog("end load pattern...\n");

    // larger vtt to avoid pre/post raw intr hit together
    uint32_t _tmp;
    _tmp = (PTN_REG_READ(phys_regs[0x1]+0x44)&0xe000ffff)|0x4000000;
    PTN_REG_WRITE(phys_regs[0x1]+0x44, _tmp); // isp_csi_bdg0.reg_vtt

    prepare_dma_buffer();

    return 0;
}

static int pattern_isp_hdr_csi2dram(void *priv)
{
    pattern_ctx *ctx = (pattern_ctx *)priv;
    uint64_t isptop, csi_bdg;
    uint64_t *phys_regs;

    ctx->is_offline_postraw = 1;

    isptop = ctx->phys_regs[ISP_BLK_ID_ISPTOP];
    csi_bdg = ctx->phys_regs[ISP_BLK_ID_CSIBDG0];

    phys_regs = ctx->phys_regs;

    ISP_WR_REG(csi_bdg, REG_ISP_CSI_BDG_T, CSI_INTERRUPT_STATUS, 0x3F);
    ISP_WR_REG(isptop, REG_ISP_TOP_T, REG_0, 0x1FF);

    uartlog("starting load pattern...\n");
    #include "patterns/isp_hdr_csi2dram/register.cfg.h"
    uartlog("end load pattern...\n");

    prepare_dma_buffer();

    return 0;
}

/*
 * isp_post_m2m - for iommu testcase.
 *      Fixed image-size: 1920x1080.
 *      Size of bayer: 0x2F7600
 *      Size of y:     0x1FA400
 *      Size of u:     0x7E900
 *      Size of y:     0x7E900
 *
 *@param bayer_addr: src bayer address
 *@param y_addr: dst's y address of yuv420 format
 *@param u_addr: dst's u address of yuv420 format
 *@param v_addr: dst's v address of yuv420 format
 */
void isp_post_m2m(uint64_t bayer_addr, uint64_t y_addr, uint64_t u_addr, uint64_t v_addr)
{
    struct isp_ctx *ictx = &m_ispctx;

    m_ptn_ctx.is_stop = 1;
    m_ptn_ctx.is_pre0_frame_done = 0;
    m_ptn_ctx.is_pre1_frame_done = 0;
    m_ptn_ctx.is_post_frame_done = 1;
    m_ptn_ctx.phys_regs = isp_get_phys_reg_bases();
    m_ptn_ctx.sc_inst = 1;

    ictx->src_width = 1920;
    ictx->src_height = 1080;
    ictx->rgb_color_mode = 1;
    ictx->csibdg_patgen_en = 0;
    ictx->is_yuv_sensor = 0;
    ictx->is_hdr_on = 0;
    ictx->is_3dnr_on = 0;
    ictx->is_tile = 0;
    ictx->is_offline_preraw = 1;
    ictx->is_offline_postraw = 1;
    ictx->is_offline_scaler = 1;
    ictx->sensor_bitdepth = 12;
    ictx->phys_regs = m_ptn_ctx.phys_regs;
    ictx->cam_id = 0;
    crop0.x = 0;
    crop0.y = 0;
    crop0.w = ictx->src_width;
    crop0.h = ictx->src_height;
    ictx->img_width = crop0.w;
    ictx->img_height = crop0.h;

    m_ptn_ctx.is_offline_postraw = ictx->is_offline_postraw;
    m_ptn_ctx.is_offline_preraw = ictx->is_offline_preraw;
    m_ptn_ctx.is_offline_scaler = ictx->is_offline_scaler;

    isp_reset(ictx);
    isp_init(ictx);

    isp_rawtop_update(ictx);
    isp_rgbtop_update(ictx);
    isp_yuvtop_update(ictx);
    ispblk_crop_config(ictx, ISP_BLK_ID_CROP2, crop0);
    ispblk_crop_enable(ictx, ISP_BLK_ID_CROP4, false);
    ispblk_crop_enable(ictx, ISP_BLK_ID_CROP5, false);
    ispblk_crop_enable(ictx, ISP_BLK_ID_CROP6, false);
    ispblk_dma_config(ictx, ISP_BLK_ID_DMA3, y_addr);
    ispblk_dma_config(ictx, ISP_BLK_ID_DMA4, u_addr);
    ispblk_dma_config(ictx, ISP_BLK_ID_DMA5, v_addr);
    ispblk_dma_enable(ictx, ISP_BLK_ID_DMA3, 1);
    ispblk_dma_enable(ictx, ISP_BLK_ID_DMA4, 1);
    ispblk_dma_enable(ictx, ISP_BLK_ID_DMA5, 1);
    ispblk_isptop_config(ictx);

    isp_post_trig(ictx);
}

static int isp_test_post_m2m(void *priv)
{
    uint64_t bayer_addr, y_addr, u_addr, v_addr;

    uartlog("image size: 1920x1080\n");
    uartlog("src bayer addr: 0x");
    scanf("%lx", &bayer_addr);
    uartlog("dst y addr: 0x");
    scanf("%lx", &y_addr);
    uartlog("dst u addr: 0x");
    scanf("%lx", &u_addr);
    uartlog("dst v addr: 0x");
    scanf("%lx", &v_addr);

    isp_post_m2m(bayer_addr, y_addr, u_addr, v_addr);
    return 0;
}

#ifdef VIP_PERFORMANCE_TEST
extern int isp_intr_handler(int irqn, void *priv);

static void try_trig_next_frame(void)
{
    pattern_ctx *ctx = &m_ptn_ctx;
    bool is_ready = ctx->is_post_frame_done && ctx->is_pre0_frame_done;

    if (mod_mask & BIT(VIP_STRESS_MOD_SC))
	    is_ready &= sc_frame_done;
    if (mod_mask & BIT(VIP_STRESS_MOD_DWA))
	    is_ready &= dwa_frame_done;

    if (is_ready) {
	if ((frame_count != 11111) && --frame_count <= 0) {
	    ISP_WR_BITS(ctx->phys_regs[ISP_BLK_ID_CSIBDG0], REG_ISP_CSI_BDG_T, CSI_CTRL, CSI_ENABLE, 0);
	    uartlog("frame_count down to zero and stop...\n ");
	} else {
	    struct isp_ctx *ictx = ctx->ptn->priv;

	    ctx->is_pre0_frame_done = 0;
	    isp_pre_trig(ictx);
	    if (!stress_cb)
		uartlog("### isp set frame_vld for pre on eof!!!\n");
	}

	if (stress_cb && (cb_mask & BIT(VIP_STRESS_CB_TYPE_EOF)))
	    stress_cb(VIP_STRESS_CB_TYPE_EOF);
    }
}

static int dwa_isr(int irqn, void *priv)
{
    u8 status = dwa_intr_status();

    dwa_intr_clr(status);
    uartlog("%s: dwa-status(0x%x)\n", __func__, status);
    if (status & 0x01) {
	dwa_frame_done = true;
	try_trig_next_frame();
    }

    return 0;
}

static int sc_isr(int irqn, void *priv)
{
    union sclr_intr intr_status = sclr_intr_status();

    sclr_intr_clr(intr_status);
    sc_intr_mask.raw ^= (intr_status.raw & sc_intr_mask.raw);
    uartlog("%s: sc-status(%#x) chk-result mask(%#x)\n", __func__, intr_status.raw, sc_intr_mask.raw);
    if (sc_intr_mask.raw == 0) {
	sc_frame_done = true;
	try_trig_next_frame();

	u32 val = _reg_read(0x0a0880c0);
	if (val & 0x700) {
	    uartlog("%s: disp catch fail(%#x)\n", __func__, val);
	    _reg_write_mask(0x0a0880c0, 0x700, val);
	    if (stress_cb && (cb_mask & BIT(VIP_STRESS_CB_TYPE_DISP_CATCH_FAIL)))
		stress_cb(VIP_STRESS_CB_TYPE_DISP_CATCH_FAIL);
	}
    }

    return 0;
}

/* configure before stress-test.
 *
 * @param test_case: 2/5/8 indicate the data amount of test pattern. default 5M.
 * @param _cb_mask: refer to enum VIP_STRESS_CB_TYPE. bit0:EOF, bit1:SOF,...
 *		   Only the ones set will callback.
 * @param _mod_mask: refer to enum VIP_STRESS_MOD_TYPE. bit0:SC, bit1:DWA,...
 *
 */
void vip_stress_config(u8 test_case, u8 _cb_mask, u8 _mod_mask)
{
    struct sclr_size src, dst;
    struct isp_ctx *ictx;

    cb_mask = _cb_mask;
    mod_mask = _mod_mask;

    uartlog(" Enabled Calbacks: (SOF) (EOF) ");
    if (cb_mask & BIT(VIP_STRESS_CB_TYPE_CSIBDG_FIFO_OVERFLOW))
	uartlog("(ISP FIFO OVERFLOW) ");
    if (cb_mask & BIT(VIP_STRESS_CB_TYPE_CSIBDG_FRAME_DROP))
	uartlog("(ISP FRAME DROP) ");
    if (cb_mask & BIT(VIP_STRESS_CB_TYPE_DISP_CATCH_FAIL))
	uartlog("(DISP CATCH FAIL) ");
    uartlog("\n");

    uartlog(" Enabled Modules: (ISP) ");
    if (mod_mask & BIT(VIP_STRESS_MOD_SC)) {
	uartlog("(SC) ");
	if (mod_mask & BIT(VIP_STRESS_MOD_OSD))
	    uartlog("(OSD) ");
    }
    if (mod_mask & BIT(VIP_STRESS_MOD_DISP))
	uartlog("(DISP) ");
    if (mod_mask & BIT(VIP_STRESS_MOD_DWA))
	uartlog("(DWA) ");
    uartlog("\n");
    uartlog("--------------------------------------------------------\n");

    m_ptn_ctx.ptn = &pattern_db[7];
    m_ptn_ctx.phys_regs = isp_get_phys_reg_bases();
    request_irq(ISP_INTR_NUM, isp_intr_handler, 0, "isp_intr", &m_ptn_ctx);
    m_ptn_ctx.is_stop = 1;
    m_ptn_ctx.is_pre0_frame_done = 0;
    m_ptn_ctx.is_pre1_frame_done = 0;
    m_ptn_ctx.is_post_frame_done = 1;

    ictx = m_ptn_ctx.ptn->priv;
    switch (test_case) {
	case 2:
	    ictx->src_width = 1920;
	    ictx->src_height = 1080;
	    ictx->is_tile = 0;
	    break;
	default:
	case 5:
	    ictx->src_width = 2688;
	    ictx->src_height = 1944;
	    ictx->is_tile = 0;
	    break;
	case 8:
	    ictx->src_width = 3840;
	    ictx->src_height = 2160;
	    ictx->is_tile = 1;
	    break;
    }
    pattern_isp_flow_manual(&m_ptn_ctx);

    // set yuv/raw, sc to offline
    _reg_write(0x0A0C8010, 7);
    _reg_write(0x0A080008, 0x20);
    // set full clk speed
    _reg_write(0x0A0C8030, 0x21084210);
    _reg_write(0x0A0C8034, 0x00084210);

    // set mac to vip_sys_clk2
    _reg_write_mask(0x0A0C801C, 0x00000ff0, 0x220);
    // set vip_sys_clk2 src from mipimpll
    _reg_write_mask(0x03002020, 0x00200000, 0x00200000);
    if (m_ispctx.img_width <= 1920) {
	// mipimpll_clk/6
	_reg_write(0x03002110, 0x00060009);
    } else if (m_ispctx.img_width == 2688) {
	// default: mipimpll_clk/3
	_reg_write(0x03002110, 0x00000001);
    } else if (m_ispctx.img_width == 3840) {
	// mipimpll_clk/2
	_reg_write(0x03002110, 0x00020009);
    }

    bool osd_on = mod_mask & BIT(VIP_STRESS_MOD_OSD);
    if (mod_mask & BIT(VIP_STRESS_MOD_SC)) {
	src.w = m_ispctx.img_width;
	src.h = m_ispctx.img_height;
	dst.w = 1920;
	dst.h = 1080;
	sc_from_isp(0, false, src, dst, post_y_addr, post_u_addr, post_v_addr, osd_on);
	dst.w = m_ispctx.img_width;
	dst.h = m_ispctx.img_height;
	sc_from_isp(1, false, src, dst, post_y_addr, post_u_addr, post_v_addr, osd_on);
	dst.w = 720;
	dst.h = 480;
	sc_from_isp(2, false, src, dst, post_y_addr, post_u_addr, post_v_addr, osd_on);
	dst.w = 320;
	dst.h = 240;
	sc_from_isp(3, false, src, dst, post_y_addr, post_u_addr, post_v_addr, osd_on);
	request_irq(SCL_INTR_SCL_NUM, sc_isr, 0, "scl int", NULL);
    }

    if (mod_mask & BIT(VIP_STRESS_MOD_DISP))
	enable_disp2k_for_test();

    if (mod_mask & BIT(VIP_STRESS_MOD_DWA)) {
	u64 src_addr[3] = {BASE_OFFSET + 0x156000000, BASE_OFFSET + 0x157000000, BASE_OFFSET + 0x158000000};
	u64 dst_addr[3] = {BASE_OFFSET + 0x159000000, BASE_OFFSET + 0x15A000000, BASE_OFFSET + 0x15B000000};
	u64 addr_mesh_id = BASE_OFFSET + 0x15C000000;
	u64 addr_mesh_tbl = BASE_OFFSET + 0x15C400000;
	u16 *mesh_id = (u16*) addr_mesh_id;
	struct fb_param fb_src, fb_dst;

	fb_src.width = m_ispctx.img_width;
	fb_src.height = m_ispctx.img_height;
	fb_src.offset_x = 0;
	fb_src.offset_y = 0;
	fb_dst.width = m_ispctx.img_height;
	fb_dst.height = m_ispctx.img_width;
	fb_dst.offset_x = 0;
	fb_dst.offset_y = 0;

	uartlog("Please make sure dwa mesh_id(0x%lx) mesh_tbl(0x%lx) has been loaded into memory\n",
		addr_mesh_id, addr_mesh_tbl);
	bm_getc();
	mesh_id[2] = addr_mesh_tbl & 0x0fff;
	mesh_id[3] = (addr_mesh_tbl >> 12) & 0x0fff;
	mesh_id[4] = (addr_mesh_tbl >> 24) & 0x0fff;
	mesh_id[5] = (addr_mesh_tbl >> 36) & 0x000f;

	dwa_reset();
	dwa_init();
	dwa_intr_ctrl(0x01);
	dwa_package_cfg(0, true, &fb_src, &fb_dst, src_addr, dst_addr, addr_mesh_id, &dwa_cfg);
	request_irq(DWA_INTR_NUM, dwa_isr, 0, "dwa int", NULL);
    }
}

int vip_stress_start(void)
{
    struct isp_ctx *ictx = &m_ispctx;

    m_ptn_ctx.is_stop = 0;
    frame_count = 11111;
    m_ptn_ctx.is_pre0_frame_done = 1;
    isp_streaming(ictx, 1);
    isp_pre_trig(ictx);
    m_ptn_ctx.is_pre0_frame_done = 0;
    return 0;
}

int vip_stress_stop(void)
{
    return patgen_isppath_stop(&m_ptn_ctx);
}

void vip_stress_register_callback(cb_func fp)
{
    stress_cb = fp;
}

static int isp_test_vip_stress(void *priv)
{
    u8 test_case, _mod_mask = 0, _cb_mask = 0;
    u32 tmp = 0;
    bool enable;

    bm_get_num("Case 2M/5M/8M: ", test_case);

    bm_get_num("Enable SC(1/0): ", enable);
    if (enable) {
	_mod_mask |= BIT(VIP_STRESS_MOD_SC);
	bm_get_num("Enable OSD(1/0): ", enable);
	if (enable) _mod_mask |= BIT(VIP_STRESS_MOD_OSD);
    }
    bm_get_num("Enable DISP(1/0): ", enable);
    if (enable) _mod_mask |= BIT(VIP_STRESS_MOD_DISP);
    bm_get_num("Enable DWA(1/0): ", enable);
    if (enable) _mod_mask |= BIT(VIP_STRESS_MOD_DWA);

    bm_get_num("Enable callback for csi fifo-overflow(1/0): ", enable);
    _cb_mask |= BIT(VIP_STRESS_CB_TYPE_SOF);
    _cb_mask |= BIT(VIP_STRESS_CB_TYPE_EOF);
    if (enable) _cb_mask |= BIT(VIP_STRESS_CB_TYPE_CSIBDG_FIFO_OVERFLOW);
    bm_get_num("Enable callback for csi frame-drop(1/0): ", enable);
    if (enable) _cb_mask |= BIT(VIP_STRESS_CB_TYPE_CSIBDG_FRAME_DROP);
    bm_get_num("Enable callback for disp catch fail(1/0): ", enable);
    if (enable) _cb_mask |= BIT(VIP_STRESS_CB_TYPE_DISP_CATCH_FAIL);

    vip_stress_config(test_case, _cb_mask, _mod_mask);
    return 0;
}
#endif
