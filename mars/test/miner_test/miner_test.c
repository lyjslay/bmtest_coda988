#include "boot_test.h"
#include "uart.h"
#include "cli.h"
#include "command.h"

#define START_ADDR	0x10A000000
#define DST_ADDR	0x10B000000

#define ARRAY_SIZE(x) (sizeof(x) / sizeof((x)[0]))
#define PAGE_SIZE 4096

#define BASE_REG	0x5800C000
#define BASE_REG2	0x5800F000

//reg1
#define HASH_ON			0x8
#define BT8D			0x3C
#define RESET_CHAIN		0x80
#define TIME_OUT_CTL		0x88
#define NONCE_FIFO_INTERRUPT	0x1C
#define ACC_CTRL		0x100
#define COINBASE_AND_NONCE2_LENGTH 	0x104
#define WORK_NONCE_2			0x108
#define NONCE2_JOBID_ADDRESS		0x110
#define MERKLE_BIN_NUMBER		0x114
#define JOB_START_ADDRESS		0x118
#define JOB_LENGTH			0x11C
#define JOB_ID				0x124
#define BLOCK_HEADER_VERSION		0x130
#define TIME_STAMP			0x134
#define TARGET_BIT			0x138
#define PRE_HEAD_HASH			0x140

//reg2
#define BM1880_CTL	0x0

#define MEM_READ	0
#define MEM_WRITE	1
#define MEM_WRITE_BLOCK	2

#define VERIFY_OK	0
#define VERIFY_FIAL	1

#define LINE_SIZE_BYTE	64
#define ACC_START	1 << 6
#define ACC_FLUSH_WORK	0x80

#define miner_writel(a, v)	writel((void *)a, v)
#define miner_readl(a)		readl((void *)a)
#define miner_readq(a)		readq((void *)a)

#define mb()	asm volatile("dsb sy" : : : "memory")

struct reg_setting_array {
	unsigned int offset;
	unsigned int value;
};

static char init_data[] = {
	0x00, 0x00, 0x00, 0x00, 0x00, 0x00, 0x00, 0x00, 0x00, 0x00, 0x00, 0x01, 0x00, 0x00, 0x00, 0x01,
	0x00, 0x00, 0x00, 0x00, 0x00, 0x00, 0x00, 0x00, 0x00, 0x00, 0x00, 0x00, 0x00, 0x00, 0x00, 0x00,
	0x4d, 0x19, 0x07, 0xeb, 0x07, 0x03, 0x52, 0xff, 0xff, 0xff, 0xff, 0x00, 0x00, 0x00, 0x00, 0x00,
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	0x2a, 0x3f, 0xa7, 0xb7, 0xfd, 0xb6, 0x75, 0xe5, 0xc1, 0xc2, 0xa2, 0x18, 0x72, 0xfc, 0x6b, 0x7c
};

/*
static struct reg_setting_array setting2[] = {
	{BM1880_CTL, (4 << 1 | 5 << 4 | 6 << 8 | 7 << 12)},
	{BM1880_CTL + 4, 0},
	{BM1880_CTL + 8, 0},
	{BM1880_CTL + 12, 0},
};
*/

static struct reg_setting_array setting[] = {
	{TIME_OUT_CTL, 0x8000000A},
	// set nonce fifo threhold to 8, enable threshold interrupt
	{BT8D, (0xb << 24) | 0x143},
	//{TIME_OUT_CTL, (1 << 31 | 500)},
	{NONCE_FIFO_INTERRUPT, 0x80000010},
	// set job start address
	{JOB_START_ADDRESS, 0xaa550000},
	// set nonce2 jobid address
	{NONCE2_JOBID_ADDRESS, 0x34560000},
	{HASH_ON, 0xfff},
	// set job_id
	{JOB_ID, 0x3},
	// set BLOCK_HEADER_VERSION
	{BLOCK_HEADER_VERSION, 0x20},
	// set pre head hash 0-7  32bits
	{PRE_HEAD_HASH, 0x563716b4},
	{PRE_HEAD_HASH + 4, 0xd797499e},
	{PRE_HEAD_HASH + 8, 0xbb457b14},
	{PRE_HEAD_HASH + 12, 0x186322b8},
	{PRE_HEAD_HASH + 16, 0x550ed5f6},
	{PRE_HEAD_HASH + 20, 0x31944000},
	{PRE_HEAD_HASH + 24, 0},
	{PRE_HEAD_HASH + 28, 0},
	// set time stamp
	{TIME_STAMP, 0x5ad85613},
	// set target bit
	{TARGET_BIT, 0x1749500d},
	// set coinbase length & nonce2 length
	{COINBASE_AND_NONCE2_LENGTH, 0x780404},
	// set work nonce2 [0]
	{WORK_NONCE_2, 0x0},
	// set work nonce2 [1]
	{WORK_NONCE_2 + 4, 0xffffffff},
	// set merkle bin no
	{MERKLE_BIN_NUMBER, 0x1255000b},
	// set job length
	{JOB_LENGTH, 0x260},
	// set acc control
	{ACC_CTRL, 0x8160},
	{TIME_OUT_CTL, 0x8000000A},
};

static int init_start_data(unsigned long start_addr)
{
	int i, j;
	unsigned char buf[16] = {0};

	for(i = 0;i < ARRAY_SIZE(init_data);i += 16) {
		for(j = 0; j <16;j++) {
			buf[j] = (init_data + i)[16 - j - 1];
		}
		memcpy((void *)start_addr, buf, 16);
		start_addr += 16;
	}
	return 0;
}

static int run_go(int loop_count)
{
	int i;
	unsigned long long count = 0;
	unsigned long long test_count = 0xfff;
	int value = 0;

	uartlog("MINERTEST enter\n");

	if(loop_count > 0)
		test_count = loop_count;

	init_start_data(START_ADDR);
	again:
	/*
	miner_writel(BASE_REG + RESET_CHAIN, 0x8000);
	mb();
	miner_writel(BASE_REG + RESET_CHAIN, 0x80008000);

	do {
		value = miner_readl(BASE_REG + RESET_CHAIN);
	} while(value & (1 << 31));
	uartlog("MINERTEST reset chain done\n");
	*/

	for (i = 0; i < ARRAY_SIZE(setting);i++) {
		if (setting[i].offset == JOB_START_ADDRESS)
			setting[i].value = START_ADDR & 0xffffffff;
		if (setting[i].offset == NONCE2_JOBID_ADDRESS)
			setting[i].value = DST_ADDR & 0xffffffff;
		if (setting[i].offset == MERKLE_BIN_NUMBER) {
			setting[i].value = (((START_ADDR >> 32) & 0xf) << 16 | (((DST_ADDR >> 32) & 0xf) << 24) | 0xb);
		}
		if (setting[i].offset == ACC_CTRL) {
			if(value)
				setting[i].value = value;
		}

		miner_writel(BASE_REG + setting[i].offset, setting[i].value);
		mb();
	}

	uartlog("MINERTEST reg setting done, start work...\n");
	/*
	for (i = 0; i < ARRAY_SIZE(setting2);i++) {
		miner_writel(BASE_REG2 + setting2[i].offset, setting2[i].value);
	}
	*/
	do {
		count = miner_readq(BASE_REG + WORK_NONCE_2);
		uartlog("MINERTEST count( 0x%llx )\n", count);
	} while ((count & 0xffffffff) < test_count);

	// stop run
	value = miner_readl(BASE_REG + ACC_CTRL);
	value &= ~ACC_START;
	miner_writel(BASE_REG + ACC_CTRL, value);

	for(;;) {
		value = miner_readl(BASE_REG + ACC_CTRL);
		if(!(value & ACC_START))
			break;
	}

	miner_writel(BASE_REG + HASH_ON, 0);

	miner_writel(BASE_REG + RESET_CHAIN, 0x8000);
	mb();
	miner_writel(BASE_REG + RESET_CHAIN, 0x80008000);

	do {
		value = miner_readl(BASE_REG + RESET_CHAIN);
	} while(value & (1 << 31));

	count = miner_readq(BASE_REG + WORK_NONCE_2);
	uartlog("MINERTEST work done, count( %llu -> %llu )\n", test_count, count);

	if(loop_count > 0)
		return 0;

	//flush work fifo
	value = miner_readl(BASE_REG + ACC_CTRL);
	value |= ACC_FLUSH_WORK;
	miner_writel(BASE_REG + ACC_CTRL, value);
	goto again;

	uartlog("MINERTEST done\n");

	return 0;
}

int do_miner_test(int argc, char **argv)
{
	int count;

	count = strtoul(argv[2], NULL, 10);
	return run_go(count);
}

int do_loop(int argc, char **argv)
{
	return run_go(-1);
}

static struct cmd_entry test_cmd_list[] __attribute__ ((unused)) = {
	{"do", do_miner_test, 2, "count [count]"},
	{"run", do_loop, 0, "run loop test"},
	{NULL, NULL, 0, NULL}
};

int testcase_miner_test(void)
{
	int i, ret;

	for(i = 0;i < ARRAY_SIZE(test_cmd_list) - 1;i++) {
		command_add(&test_cmd_list[i]);
	}
    do {
      ret = cli_simple_loop();
    } while (ret == 0);
	return 0;
}
//module_testcase("1", testcase_miner_test);

#ifndef BUILD_TEST_CASE_all
int testcase_main()
{
	return testcase_miner_test();
}
#endif

